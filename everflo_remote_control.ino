/* ============================================================
 *  EverFlo remote control – XIAO ESP32-S3 Sense
 *  ------------------------------------------------------------
 *  Features:
 *   - Captive portal for wifi setup (WiFiManager)
 *   - MJPEG camera stream (port 81) of the flow meter ball
 *   - Swedish web page (port 80) with large +/− buttons
 *   - Motor control: NEMA17+TMC2209 (STEP/DIR/EN)
 *   - Freewheel between adjustments (EN pin)
 *   - Position counter kept in flash (informational only – the
 *     camera is the truth; the knob can be turned by hand or slip)
 *   - Camera sensor PID written to the serial log at boot
 *
 *  Code and comments are English; all user-facing text stays
 *  Swedish (the patient reads it). Wire formats – URLs, JSON
 *  field names, NVS keys – keep their original names on purpose:
 *  renaming them would break the control panel or lose the
 *  stored position.
 *
 *  Arduino IDE settings:
 *   Board: "XIAO_ESP32S3"  (esp32 by Espressif, v3.x)
 *   PSRAM: "OPI PSRAM"  (required by the camera!)
 *   Libraries: "WiFiManager" (tzapu) via Library Manager
 *              "TMCStepper" only when USE_TMC_UART is 1
 *
 *  Calibration: see README_koppling.md
 * ============================================================ */

#include "esp_camera.h"
#include <WiFi.h>
#include <WiFiClientSecure.h>
#include <HTTPClient.h>
#include <WiFiManager.h>          // tzapu – captive portal
#include <ESPmDNS.h>
#include <ArduinoOTA.h>
#include <HTTPUpdate.h>
#include <Preferences.h>
#include "esp_http_server.h"
#include "esp_log.h"
#include "mbedtls/md.h"        // HMAC-SHA256 for the control key (bundled with the core)
#include "balldetector_js.h"   // GENERATED by build_webui.mjs

/* Local, gitignored. See secrets.h.example. Everything it configures is
   optional: without the file the sketch still builds, with the feature off. */
#if __has_include("secrets.h")
  #include "secrets.h"
#endif
#ifndef HEALTHCHECK_URL
  #define HEALTHCHECK_URL ""      // empty = health ping disabled
#endif
#ifndef INGEST_URL
  #define INGEST_URL ""           // empty = cloud upload disabled
#endif
#ifndef INGEST_TOKEN
  #define INGEST_TOKEN ""
#endif
#ifndef OTA_PASSWORD
  #define OTA_PASSWORD ""         // empty = OTA disabled, and it stays disabled
#endif                            // rather than open. See otaInit().
#ifndef CONTROL_KEY
  #define CONTROL_KEY ""
#endif

/* ---------------- ACCESS CONTROL ----------------
   1 = everything that turns the knob or changes the device (plus/minus, step
   size, light, colour test, restart, firmware check, counter reset) needs
   CONTROL_KEY from secrets.h. Watching — the picture, the reading, status and
   the log — stays open to anyone on the network. 0 = as before 1.11.5: open,
   or WEB_PIN if one is set. For a shared or public wifi; see "Access control"
   in CLAUDE.md. A build, not a switch in the app: a toggle that turns the
   lock off would itself need the lock. MINOR version (1.12.0): turning it on
   needs more than a flash — her phone must be paired, or her buttons are
   hidden until it is. */
#define CONTROL_AUTH    1
#if CONTROL_AUTH
  static_assert(sizeof(CONTROL_KEY) > 16,
                "CONTROL_AUTH 1 needs a CONTROL_KEY of at least 16 characters in secrets.h");
#endif

/* Minor when flashing is not the whole job — new hardware, a new library, or
   a recalibration is required. Patch when flashing is all there is to do.
   1.10.0 is minor because a pixel has to be wired in and the calibration must
   be swept again under the new light.

   1.7.0 and 1.8.0 fit that rule; 1.9.0 did not — it was a bug fix, and the
   only thing pushing it over was habit, because 1.8.10 was there for the
   taking. These fields are numbers, not digits, which is also what makes
   1.10.0 a step up from 1.9.7 rather than a step back. Nothing sorts them
   anyway: the firmware, the Worker and publish_firmware.mjs all compare for
   equality only. */
#define FW_VERSION "1.13.0"

/* ---------------- MOTOR ---------------- */
#define USE_TMC_UART 0            // 1 = current control + true freewheel over UART
                                  //     (needs TMCStepper library + 1k resistor, see README)

/* ---------------- CONCENTRATOR ----------------
   Which machine this build drives. Everything that was tuned for one model
   lives in its block: the preset the detection engine reads the meter with
   (PRESETS in balldetector.js, by id), the step sizes on her buttons and the
   direction the knob turns. Chosen here and nowhere else — not on the page and
   not over the API. She cannot switch it, and neither can a stray request: a
   machine swap is a visit anyway (cup, mount, camera, light), and a build is
   the one place a wrong choice cannot quietly persist.

   The preset id goes to the device page, to /api/status for the control panel,
   and with every upload so the admin page reads each frame with the preset it
   was taken under. Switching back is: set this line, bump FW_VERSION, flash. */
#define CONC_EVERFLO    1
#define CONC_PLATINUM9  2
#define CONCENTRATOR    CONC_PLATINUM9

#if CONCENTRATOR == CONC_EVERFLO
  #define PRESET_ID       "everflo"
  #define DEG_PER_PRESS   39      // motor shaft degrees per button press, and her
                                  // smallest button. Calibrated on site against
                                  // the ball 2026-08-16, replacing the earlier
                                  // 15° Lego estimate.
  #define STEP_MEDIUM     90      // her ++ and −− buttons
  #define STEP_LARGE      160     // her +++ and −−− buttons
  #define DIRECTION       -1      // 1 or -1 when + turns the wrong way
                                  // (-1 since v1.6.2: verified on site)
  #define LED_LEVEL       50      // ~20% of full. All three EverFlo references
                                  // were built under it — see the light section
#elif CONCENTRATOR == CONC_PLATINUM9
  #define PRESET_ID       "platinum9"
  /* Chosen on the unit 2026-09-26, "for now": the smallest about the
     EverFlo's, the two larger ones shorter (60/120 against 90/160) on a knob
     where 1 L/min is ~21 image rows (since the 2026-09-29 camera move). The same cup fits, and the direction
     carried over from the EverFlo unchanged. */
  #define DEG_PER_PRESS   30      // 40 until 1.12.12 (2026-09-30, the operator's call)
  #define STEP_MEDIUM     60
  #define STEP_LARGE      120
  #define DIRECTION       -1
  /* The level the 2026-09-29 sweep and its reference were taken at (the
     compiled default, assuming the panel's light slider was not moved),
     bound to the preset exactly as EverFlo's references are bound to 50.
     Change it and the Platinum needs a new sweep. */
  #define LED_LEVEL       50
#else
  #error "CONCENTRATOR must be CONC_EVERFLO or CONC_PLATINUM9"
#endif

/* ---------------- MOVEMENT ---------------- */
#define STEP_DEG_MIN    4        // clamp range for a press, whether it comes from
#define STEP_DEG_MAX    180       // /api/steg or ?steg=N on a press. Half a turn is
                                  // a lot of flow in one press — the ceiling exists
                                  // so a bad request cannot spin the knob, not to
                                  // second-guess a deliberate one. Raised from 90
                                  // for calibration work 2026-08-16.
#if DEG_PER_PRESS < STEP_DEG_MIN || DEG_PER_PRESS > STEP_MEDIUM || STEP_MEDIUM > STEP_LARGE || STEP_LARGE > STEP_DEG_MAX
  // A button whose step the clamp silently changes would turn a different
  // amount than its preset says, with nothing on her page to show it.
  #error "Preset step sizes must satisfy STEP_DEG_MIN <= DEG_PER_PRESS <= STEP_MEDIUM <= STEP_LARGE <= STEP_DEG_MAX"
#endif
#define MICROSTEPS      8         // TMC2209 standalone: MS1=MS2=GND => 1/8
#define STEP_PAUSE_US   1800      // µs between microsteps at cruise (lower = faster).
                                  // 125 deg/s. A stepper runs far faster once moving
                                  // than it can start from standstill, which is what
                                  // the ramp below is for — raise the speed here, not
                                  // the jolt at the ends.
#define STEP_RAMP_US    3700      // extra µs at the very start and end of a move, so
                                  // the first step is still a gentle 41 deg/s
#define STEP_RAMP_MAX   100       // microsteps spent easing in, and again easing out

/* ---------------- SECURITY ---------------- */
#define WEB_PIN ""                // e.g. "4711" => requires ?pin=4711 on API calls.
                                  // Empty = off (simplest for the patient; anyone on
                                  // the home network can control the motor)

/* ---------------- CAMERA ---------------- */
#define CAMERA_VFLIP    0         // 1 when the image is upside down
#define CAMERA_HMIRROR  0         // 1 when mirrored

/* ---------------- PINS ---------------- */
#define PIN_STEP D0
#define PIN_DIR  D1
#define PIN_EN   D2               // active LOW. HIGH = driver off = freewheel
#define PIN_TMC_RX D7             // UART mode only
#define PIN_TMC_TX D6

/* ---------------- LIGHT (WS2812D-F5, one pixel) ---------------- */
/* Lights the flow meter for the camera. Wiring: VCC -> XIAO 5V, GND -> GND,
   Din -> D3. The 5V pin is USB VBUS and this draws ~22 mA at the level below,
   so it does not touch iron rule 1 — that rule is about the motor rail, which
   is amps and still comes from the MB102 alone.

   Data is 3.3 V into a 5 V-powered pixel. The WS2812D-F5 datasheet
   (WS2812D-F5-1261) puts VIH at 2.7 V so this is within spec, unlike the
   plain WS2812B where VIH is 0.7*VDD = 3.5 V. If a future batch turns out
   flaky, the fix is a diode in series with VCC (drops it to ~4.4 V and with
   it the threshold), not raising the data line.

   Colour order is RGB for this part, not the usual GRB. It only matters for
   /api/led-test: the working light is neutral white, where R=G=B and the
   order cannot be observed. If the test shows green where the code says red,
   change LED_ORDER to LED_COLOR_ORDER_GRB and reflash. */
#define PIN_LED_LIGHT   D3        // GPIO4
#define LED_ORDER       LED_COLOR_ORDER_RGB
/* One level, always the same, because the calibration is bound to it. A dim
   idle plus a bright flash per frame was the obvious design and is the wrong
   one: the control panel polls /bild once a second, so it would strobe over
   the meter someone is trying to read, and every analysed frame has to be lit
   identically anyway. Neutral white, so R=G=B and the colour order cannot
   show. 50 was picked on the rig on 2026-08-22, replacing a first guess of
   153; whatever number ends up here is the light the calibration sweep must
   be taken under, because the sweep is what binds the two together.
   That makes it per machine: LED_LEVEL is defined in the CONCENTRATOR block,
   beside the preset whose references were built under it. */

/* 1 = simply lit, boot to power-off. This is the default, and the reason is
   the detector rather than convenience.

   The unit stands in the kitchen, not in her room — that is the whole point
   of a remote control — and a small desk lamp has been burning on the meter
   around the clock so the night picture is readable at all. So constant light
   is already the accepted state of the room; the pixel replaces the lamp, it
   does not add anything to it.

   Switching it on and off would be actively worse than either. In daylight
   the ambient dominates and the pixel is a small fixed addition; if it comes
   and goes with whoever happens to be watching, every frame is lit one of two
   ways on top of an ambient that already varies. Constant means one lighting,
   which is the only thing the calibration can be bound to.

   0 = lit only while the picture is in use (LED_AFTER_* below). That path is
   compiled, reviewed and ready; it is not the default yet, deliberately.

   Two reasons it stays at 1 for now. Power is not one of them: at level 50
   the pixel draws about 8 mA against the 100-200 mA the board already pulls,
   off the 5V pin, which is USB VBUS straight through and never touches the
   XIAO's own regulators.

   The first is sequencing. The calibration is swept with the light constantly
   on and the exposure long since settled — the control panel polls /bild once
   a second throughout a sweep, so it cannot be swept any other way. Changing
   the light mode in the same breath as the calibration would leave any
   trouble the next day belonging to either of them.

   The second is what conditional actually costs: the 15-minute cloud upload
   fires with nobody watching, so it is a COLD capture every time, and those
   are the frames that become the permanent record. If LED_SETTLE_MS is not
   long enough the contrast gate refuses them and the archive goes patchy in
   exactly the place it is the only witness. That is measurable — flip this to
   0, let it run a night, and score the uploads — but measure it on its own,
   after a calibration that is already known to work. */
#define LED_ALWAYS_ON   1

/* The pulse window MUST exceed the heartbeat interval, or the lamp blinks out
   between two beats while someone is standing there reading it. Both pages
   beat every 5 s, so 15 s survives two lost beats and still goes dark 10-15 s
   after the last page closes. Raise one of these and you must raise the
   other. The frame window is what actually holds it on while a page is being
   watched — /bild arrives four times a second — so the pulse only becomes
   load-bearing during a network hiccup, which is the whole reason it exists. */
#define LED_AFTER_FRAME_MS  3000UL   // lit this long after a capture
#define LED_AFTER_PULSE_MS 15000UL   // ... and this long after a UI heartbeat
/* Two settle times, because the two cold callers cost completely different
   things. 200 ms — five frames — is not enough for auto-exposure coming back
   from a dark room, but the fix is not one longer number.

   /bild has somebody waiting, and the delay runs on the port-80 task, which
   is the one task ALL handlers share: a second of it stalls the +/- buttons
   too, exactly when she has just opened the page. It also does not need long,
   because the next frame is 250 ms behind and an underexposed one is refused
   by the contrast gate rather than believed.

   The upload has nobody waiting, gets one shot, and becomes the permanent
   record. It already blocks loop() for seconds inside the TLS POST, so a
   second and a half more is free, and it is the only place where getting the
   exposure wrong costs something that cannot be retaken.

   Both are considered guesses, not measurements. Check them against real
   uploads with tools/score_uploads.mjs once the unit has run a night on
   LED_ALWAYS_ON 0. */
#define LED_SETTLE_MS        300     // /bild: someone is waiting, and so is the motor
#define LED_SETTLE_UPLOAD_MS 1500    // the archive frame: nobody waiting, no retake
/* A WS2812 latches what it was last sent and there is no way to read it back,
   so a frame corrupted on the wire — this pixel lives a few centimetres from
   a stepper being switched — would stay wrong until someone rebooted the
   unit, while the firmware went on believing the meter was lit correctly.
   Rewriting the same value every ten seconds costs 30 microseconds and turns
   that from permanent into a ten-second blip. */
#define LED_REFRESH_MS     10000UL

#if USE_TMC_UART
  #include <TMCStepper.h>
  #define R_SENSE 0.11f
  TMC2209Stepper tmc(&Serial1, R_SENSE, 0b00);
#endif

/* ---------------- CAMERA PINS (XIAO ESP32-S3 Sense) --------- */
#define CAM_PWDN  -1
#define CAM_RESET -1
#define CAM_XCLK  10
#define CAM_SIOD  40
#define CAM_SIOC  39
#define CAM_Y9    48
#define CAM_Y8    11
#define CAM_Y7    12
#define CAM_Y6    14
#define CAM_Y5    16
#define CAM_Y4    18
#define CAM_Y3    17
#define CAM_Y2    15
#define CAM_VSYNC 38
#define CAM_HREF  47
#define CAM_PCLK  13

/* ---------------- GLOBALS ---------------- */
Preferences prefs;
volatile int position = 0;        // current position in number of presses
volatile bool busy = false;       // motor is moving
volatile int stepDegrees = DEG_PER_PRESS;  // degrees/press, adjustable via /api/steg
                                           // (RAM only – reboot restores the default)
bool cameraOK = false;
httpd_handle_t ctrl_httpd = NULL;
httpd_handle_t stream_httpd = NULL;
volatile uint32_t stream_gen = 0;   // a new viewer kicks out the old one
#define HEARTBEAT_PIN 21            // XIAO user LED (active low): blink = alive

/* Log ring – latest lines reachable via http://<ip>/log */
String logBuf[40]; int logIdx = 0;
void logLine(const String &s) {
  Serial.println(s);
  logBuf[logIdx % 40] = s;
  logIdx++;
}

/* ============================================================
 *  MOTOR
 * ============================================================ */
int stepsFor(int degrees) {       // microsteps for a given angle
  return (int)(degrees / (1.8f / MICROSTEPS) + 0.5f);
}
/* No size penalty any more. Slowing big steps down was meant to let the eye
   follow the ball, but it compounded into 5.6 s for a half turn and the ramp
   already gives a soft start and stop. Cruise speed is one constant now. */
int stepPauseFor(int degrees) { (void)degrees; return STEP_PAUSE_US; }
void motorInit() {
  pinMode(PIN_STEP, OUTPUT);
  pinMode(PIN_DIR,  OUTPUT);
  pinMode(PIN_EN,   OUTPUT);
  digitalWrite(PIN_EN, HIGH);     // start in freewheel
#if USE_TMC_UART
  Serial1.begin(115200, SERIAL_8N1, PIN_TMC_RX, PIN_TMC_TX);
  tmc.begin();
  tmc.rms_current(600);           // mA – plenty for the knob, runs cool
  tmc.microsteps(MICROSTEPS);
  tmc.ihold(0);                   // no holding current
  tmc.freewheel(1);               // true freewheel at standstill
#endif
}
void motorEngage()  { digitalWrite(PIN_EN, LOW);  delay(30); }
void motorRelease() { digitalWrite(PIN_EN, HIGH); }         // freewheel
/* Trapezoidal ramp: ease in over the first steps, ease out over the last.
   A hard start and stop jolts the whole rig — including the camera bolted
   next to it, which slid 34 px on 2026-08-16 during a session of pressing. */
void motorStep(int direction, int degrees) {
  digitalWrite(PIN_DIR, (direction * DIRECTION) > 0 ? HIGH : LOW);
  const int n = stepsFor(degrees);
  const int cruise = stepPauseFor(degrees);
  // Same ramp length whatever the move: it only shrinks when the move is too
  // short to fit an ease in and an ease out, and then the profile becomes a
  // triangle that never reaches cruise. Short presses are gentler for it.
  const int ramp = min(n / 2, STEP_RAMP_MAX);
  for (int i = 0; i < n; i++) {
    int extra = 0;
    if (ramp > 0) {
      if (i < ramp)            extra = STEP_RAMP_US * (ramp - i) / ramp;
      else if (i >= n - ramp)  extra = STEP_RAMP_US * (i - (n - ramp) + 1) / ramp;
    }
    digitalWrite(PIN_STEP, HIGH); delayMicroseconds(4);
    digitalWrite(PIN_STEP, LOW);  delayMicroseconds(cruise + extra);
  }
}

/* Set by move(), read by loop(): upload one frame once a press series has
   gone quiet. What we wait for is the end of the series, not the ball —
   it settles in well under a second. */
volatile unsigned long lastPressAt = 0;
/* The direction of the last move, by whoever made it (+1 plus, -1 minus, 0
   none since boot). Her page pays the knob's backlash only when turning the
   other way, and only the device knows the last direction across her page,
   the control panel and a second phone. A turn by hand it cannot know. */
volatile int lastMoveDir = 0;
volatile bool uploadAfterPress = false;
volatile int lastPressDegrees = 0;   // signed: what the knob was actually turned
volatile bool otaActive = false;     // an over-the-air update is in progress

/* Move + store position (the counter is information, not a limit) */
bool move(int direction, int degrees) {
  // otaActive, not just busy: the press handlers run on the web server's task,
  // so a button pressed during an update would otherwise turn the knob while
  // the app partition is being rewritten. loop() withholds ArduinoOTA.handle()
  // while the motor moves; this is the other half of that interlock.
  if (busy || otaActive) return false;
  int next = position + direction;
  busy = true;
  motorEngage();
  motorStep(direction, degrees);
  motorRelease();
  position = next;
  prefs.putInt("lage", position);           // NVS key kept: renaming loses the stored position
  lastPressDegrees = direction * degrees;
  lastMoveDir = direction;
  logLine(String("Press ") + (lastPressDegrees > 0 ? "+" : "") + lastPressDegrees +
          " deg, position " + position);
  lastPressAt = millis();
  uploadAfterPress = true;
  busy = false;
  return true;
}

/* ============================================================
 *  CAMERA
 * ============================================================ */
bool cameraInit() {
  camera_config_t c = {};
  c.ledc_channel = LEDC_CHANNEL_0;
  c.ledc_timer   = LEDC_TIMER_0;
  c.pin_d0=CAM_Y2; c.pin_d1=CAM_Y3; c.pin_d2=CAM_Y4; c.pin_d3=CAM_Y5;
  c.pin_d4=CAM_Y6; c.pin_d5=CAM_Y7; c.pin_d6=CAM_Y8; c.pin_d7=CAM_Y9;
  c.pin_xclk=CAM_XCLK; c.pin_pclk=CAM_PCLK;
  c.pin_vsync=CAM_VSYNC; c.pin_href=CAM_HREF;
  c.pin_sccb_sda=CAM_SIOD; c.pin_sccb_scl=CAM_SIOC;
  c.pin_pwdn=CAM_PWDN; c.pin_reset=CAM_RESET;
  c.xclk_freq_hz = 20000000;
  c.pixel_format = PIXFORMAT_JPEG;
  c.frame_size   = FRAMESIZE_VGA;   // 640x480 – right size for the ball
  c.jpeg_quality = 12;
  c.fb_count     = 2;
  c.fb_location  = CAMERA_FB_IN_PSRAM;
  // LATEST, not WHEN_EMPTY. The driver's own header says WHEN_EMPTY means
  // "first 'fb_count' frames might be old" — and they can be minutes old
  // after a quiet spell, because capture stops once both buffers are full.
  // Observed 2026-08-15: /bild served a frame from a minute earlier, so the
  // page showed the past while claiming to show the present. That is the one
  // thing this system must never do. LATEST keeps the queue current at the
  // cost of capturing continuously; the FB-OVF chatter it can produce is
  // already silenced below, and the unit runs on mains.
  // Pixel geometry and format are untouched, so the calibration is unaffected.
  c.grab_mode    = CAMERA_GRAB_LATEST;

  if (esp_camera_init(&c) != ESP_OK) return false;

  sensor_t *s = esp_camera_sensor_get();
  if (s) {
    const char *name = "unknown";
    if      (s->id.PID == 0x3660) name = "OV3660 (new camera)";
    else if (s->id.PID == 0x26)   name = "OV2640 (older camera)";
    else if (s->id.PID == 0x5640) name = "OV5640";
    Serial.printf("Camera sensor PID=0x%04x -> %s\n", s->id.PID, name);
    s->set_vflip(s, CAMERA_VFLIP);
    s->set_hmirror(s, CAMERA_HMIRROR);
  }
  return true;
}

/* ============================================================
 *  LIGHT
 *  One addressable pixel aimed at the flow meter, replacing the desk lamp
 *  that has been standing in for it. Constant by default — see
 *  LED_ALWAYS_ON above for why, and for the one brightness.
 *
 *  The machinery below is what LED_ALWAYS_ON 0 needs; with it at 1 the
 *  windows never expire, ledApply() never sees a transition, and the
 *  settle delay never fires.
 * ============================================================ */
SemaphoreHandle_t ledMutex = NULL;
bool ledLit = false;                        // guarded by ledMutex: ledApply()
                                            // runs on both tasks
volatile unsigned long lastCaptureAt = 0;   // a frame was taken for someone
volatile unsigned long lastUiPulseAt = 0;   // a page said it is being looked at
volatile bool ledTestRunning = false;       // set by the handler, cleared in loop()
int ledTestStep = -1;                       // loop() only — see ledTestUpdate()
unsigned long ledTestStepAt = 0;            // loop() only: when this colour went up

/* 0 means "never happened", which matters at boot: millis() starts near zero
   and a plain age check would read as "just now" for the first few seconds.
   Unsigned subtraction handles the 49-day rollover on its own. */
static bool within(unsigned long stamp, unsigned long window) {
  return stamp != 0 && millis() - stamp < window;
}

/* Runtime light settings, RAM only — exactly the contract /api/steg has, and
   for the same reason. You cannot pick a light level for a detector by taste:
   you set it and watch contrast and ambiguity move on the control panel. But
   the unit must never be left standing in a half-finished experiment, so a
   reboot, a power blip, an OTA or a wifi drop all put the compiled constants
   back. What a session finds gets baked into LED_LEVEL and reflashed. */
volatile bool     lightEnabled = true;      // /api/light?on=0 forces it dark
volatile int      lightLevel   = LED_LEVEL;
volatile uint8_t  lightR = 255, lightG = 255, lightB = 255;   // tint, scaled by level
volatile bool     ledDirty = false;         // level/tint moved: rewrite even
                                            // though the lit state did not change
unsigned long ledLitAt  = 0;   // guarded by ledMutex: last dark -> lit transition
unsigned long ledWroteAt = 0;  // guarded by ledMutex: last write of any kind

/* Callers already holding ledMutex. The tint is what makes "off" and "a
   colour" the same operation: level 0 writes black whatever the tint is. */
static void ledSetLocked(bool lit) {
  int l = lit ? lightLevel : 0;
  rgbLedWriteOrdered(PIN_LED_LIGHT, LED_ORDER,
                     (uint8_t)(lightR * l / 255),
                     (uint8_t)(lightG * l / 255),
                     (uint8_t)(lightB * l / 255));
}

/* The pixel is written from loop() AND from the web server's task, which are
   different FreeRTOS tasks. A collision would at worst garble one pixel, but
   this runs unattended for months and serialising it is three lines. */
void ledWrite(uint8_t r, uint8_t g, uint8_t b) {
  if (ledMutex) xSemaphoreTake(ledMutex, portMAX_DELAY);
  rgbLedWriteOrdered(PIN_LED_LIGHT, LED_ORDER, r, g, b);
  if (ledMutex) xSemaphoreGive(ledMutex);
}
void ledSet(bool lit) {
  if (ledMutex) xSemaphoreTake(ledMutex, portMAX_DELAY);
  ledSetLocked(lit);
  if (ledMutex) xSemaphoreGive(ledMutex);
}

/* A plain `if` rather than `#if`: the compiler folds the constant either way,
   but with #if the windows below become unreachable *text* and within() reads
   as dead code the build then warns about. Both paths stay compiled here, so
   flipping LED_ALWAYS_ON cannot uncover a branch that has quietly rotted. */
bool ledShouldBeLit() {
  if (!lightEnabled) return false;          // the runtime override wins
  if (LED_ALWAYS_ON) return true;
  return within(lastCaptureAt, LED_AFTER_FRAME_MS) ||
         within(lastUiPulseAt, LED_AFTER_PULSE_MS);
}

/* Brings the pixel to the state the rules ask for.

   The whole read-compare-write is inside the mutex because ledApply() runs on
   both tasks: a capture handler calls it, and so does loop(). */
void ledApply() {
  if (ledTestRunning) return;               // the test owns the pixel
  if (ledMutex) xSemaphoreTake(ledMutex, portMAX_DELAY);
  bool want = ledShouldBeLit();
  if (want != ledLit || ledDirty || millis() - ledWroteAt > LED_REFRESH_MS) {
    if (want && !ledLit) ledLitAt = millis();
    ledLit = want;
    ledDirty = false;
    ledWroteAt = millis();
    ledSetLocked(want);
  }
  if (ledMutex) xSemaphoreGive(ledMutex);
}

/* Light the meter for a capture that is about to happen, and wait for the
   exposure if the light has not been on long enough yet.

   The wait is on how long the pixel has BEEN lit, not on whether this call
   was the one that lit it. Both UIs open by sending /api/ui-pulse and then
   asking for a frame, so in the ordinary cold start it is the pulse that
   switches the light on and the frame arrives milliseconds later — and a
   version that waited only when it did the switching itself would skip the
   settle on exactly the capture the settle exists for.

   200 ms is about five frames at VGA/20 MHz, which is what the sensor's
   auto-exposure needs to come back from the dark. A frame taken too early is
   underexposed, and an underexposed frame fails the engine's contrast gate
   rather than producing a plausible wrong number — the safe direction, and
   the next frame 250 ms later is right anyway.

   Nothing here fires while LED_ALWAYS_ON is 1: the light went on at boot and
   the elapsed time has been hours. `settle` is the caller's own budget — see
   LED_SETTLE_MS and LED_SETTLE_UPLOAD_MS. */
void ledForCapture(unsigned long settle) {
  lastCaptureAt = millis();
  ledApply();
  if (ledMutex) xSemaphoreTake(ledMutex, portMAX_DELAY);
  bool lit = ledLit;
  unsigned long on = millis() - ledLitAt;
  if (ledMutex) xSemaphoreGive(ledMutex);
  // Dark on purpose (/api/light?on=0) means there is nothing to settle for.
  if (lit && on < settle) delay(settle - on);
}

/* Red, green, blue, white — one second each, to check the wiring and the
   colour order. Driven from loop() rather than looped inside the handler:
   all port-80 handlers share one task, so four seconds of sleeping there
   would freeze the +/- buttons with it.

   Each colour is held for a second of loop time MEASURED FROM WHEN IT WAS
   ACTUALLY SHOWN, not from the start of the test. Deriving the step from the
   clock looks equivalent and is not: loop() blocks for whole seconds inside
   uploadFrame()'s TLS POST, and for up to a minute inside checkFirmware().
   Tap the button while a press upload is going out — five seconds after a
   press, so exactly when someone is exercising the motor and the wiring
   together — and the clock-driven version skips colours, or finds step >= 4
   on its first pass and logs "done" having shown nothing. This is the test
   that decides RGB versus GRB. Running long is fine; skipping green is not,
   because it reads as "the pixel is wrong" and costs a reflash and a drive.

   Re-tapping during a run is ignored rather than restarting: nothing is
   gained by cutting a sequence short, and it keeps every one of these
   variables owned by loop() alone. */
#define LED_TEST_STEP_MS 1000UL
void ledTestUpdate() {
  // The white step is the compiled LED_LEVEL, not whatever the slider is on:
  // this is a reference the test always ends at, so "is white white" has the
  // same answer during an experiment as outside one.
  static const uint8_t SEQ[4][3] = {
    {255, 0, 0}, {0, 255, 0}, {0, 0, 255}, {LED_LEVEL, LED_LEVEL, LED_LEVEL}
  };
  if (!ledTestRunning) { ledTestStep = -1; return; }   // armed runs start at 0
  if (ledTestStep >= 0 && millis() - ledTestStepAt < LED_TEST_STEP_MS) return;
  ledTestStep++;
  if (ledTestStep >= 4) {
    ledTestStep = -1;
    ledLit = ledShouldBeLit();              // hand the pixel back to the rules
    ledSet(ledLit);
    ledTestRunning = false;   // last: ledApply() stays out until the pixel is
                              // back to the state the rules want
    logLine("LED test: done");
    return;
  }
  ledTestStepAt = millis();
  ledWrite(SEQ[ledTestStep][0], SEQ[ledTestStep][1], SEQ[ledTestStep][2]);
}

void ledInit() {
  ledMutex = xSemaphoreCreateMutex();
  ledLit = false;
  ledSet(false);            // a pixel powers up in an undefined state
  ledApply();               // ... and comes straight back on when it is constant
  logLine(LED_ALWAYS_ON ? "Light: WS2812 on D3, constant"
                        : "Light: WS2812 on D3, lit only while the picture is in use");
}

/* ============================================================
 *  WEB
 *  The page text is Swedish on purpose – the patient reads it.
 * ============================================================ */
static const char PAGE[] = R"HTML(
<!DOCTYPE html><html lang="sv"><head>
<meta charset="utf-8">
<meta name="viewport" content="width=device-width,initial-scale=1,user-scalable=no">
<meta name="apple-mobile-web-app-capable" content="yes">
<meta name="mobile-web-app-capable" content="yes">
<meta name="apple-mobile-web-app-title" content="Syrgas">
<title>Syrgas – fjärrkontroll</title>
<style>
 body{font-family:-apple-system,Helvetica,Arial,sans-serif;margin:0;background:#f4f4f2;
      display:flex;flex-direction:column;align-items:center;gap:12px;padding:12px}
 h1{font-size:1.1rem;margin:4px 0 0;color:#777;font-weight:600}
 #flow{font-size:3.4rem;font-weight:800;color:#1c8a4c;line-height:1;text-align:center}
 #flow small{font-size:1.1rem;color:#666;font-weight:400}
 #flow.warn{color:#b8860b}
 /* Flow-step buttons when the machine's knob is measured and a reading
    exists; the fixed-degree buttons otherwise. Never both, never neither. */
 .buttons.flow{display:none}
 body.flowmode .buttons.flow{display:flex}
 body.flowmode .buttons.deg{display:none}
 body.unpaired .buttons{display:none!important}
 #mode{font-size:.95rem;color:#8a5a00;text-align:center;min-height:1.2em}
 #flow.none{color:#a33;font-size:1.7rem}
 /* Sized by viewport height, not width: what she is looking at is a tall
    narrow tube, and the crop below makes it taller and narrower still. Left
    to width:100% the element would be stretched to the wrapper and then
    letterboxed back down by object-fit, wasting most of the screen on black. */
 /* min-width is for the stale banner, not the picture. #stale is absolutely
    positioned left:0/right:0 INSIDE this wrapper, and after the crop the
    wrapper shrink-wraps a narrow canvas (the preset's crop: 225x640 on the
    EverFlo, 140x400 on the Platinum) — on a phone about 150 px across, which would break the one warning on this page that has to be read
    at a glance into eight characters a line. The canvas is centred and the
    spare width takes the PAGE's background, not black — the picture then sits
    on the page rather than in a letterbox. Keep this colour and body's the
    same; they are two literals that have to agree, and nothing enforces it. */
 #camwrap{width:auto;min-width:min(320px,92vw);max-width:100%;overflow:hidden;
          border-radius:12px;justify-content:center;
          background:#f4f4f2;position:relative;display:flex}
 #cv{height:52vh;width:auto;max-width:100%;display:block}
 #camwrap.stale #cv{opacity:.3}
 #stale{display:none;position:absolute;left:0;right:0;top:50%;transform:translateY(-50%);
        background:#a33;color:#fff;text-align:center;padding:14px 10px;
        font-size:1.1rem;font-weight:700;line-height:1.35}
 #stale small{display:block;font-size:.85rem;font-weight:400;margin-top:4px}
 #camwrap.stale #stale{display:block}
 /* Three step sizes across, plus over minus. The symbol says how big the
    step is, so there is nothing to read. */
 .buttons{display:flex;flex-direction:column;gap:10px;width:100%;max-width:480px}
 .buttons .row{display:flex;gap:10px;width:100%}
 /* flex-basis 0 so all three are equal no matter how many symbols they
    carry, and min-width 0 so the symbols cannot push a column wider. */
 .buttons button{flex:1 1 0;min-width:0}
 button{font-size:2rem;padding:22px 0;border:none;letter-spacing:.08em;
        border-radius:16px;color:#fff;font-weight:700;cursor:pointer}
 .plus{background:#1c8a4c}
 .minus{background:#b3382c}
 button:disabled{opacity:.45}
 #msg{min-height:1.3em;font-size:1rem;color:#a33;text-align:center;max-width:480px}
 #pair{font-size:.95rem;color:#8a5a00;text-align:center;max-width:480px}
 /* Pairing inside the page: a home-screen web app has its own storage and no
    address bar, so a #k= link opened in Safari never reaches it. */
 #pairform{display:flex;gap:8px;width:100%;max-width:480px}
 #pairform[hidden]{display:none}
 #pairin{flex:1 1 0;min-width:0;font-size:1rem;padding:10px;border:1px solid #bbb;border-radius:10px}
 #pairform button{font-size:1.1rem;padding:10px 18px;background:#555;letter-spacing:0}
 .small{font-size:.85rem;color:#888;margin-top:12px;text-align:center}
</style></head><body>
<h1>Syrgas</h1>
<div id="camwrap"><canvas id="cv" width="225" height="640"></canvas>
<div id="stale">Bilden uppdateras inte<small id="staleAge"></small></div></div>
<div id="flow">–<small> L/min</small></div>
<div id="mode"></div>
<div class="buttons flow">
<div class="row">
<button class="plus" onclick="pressFlow(1)">+1</button>
<button class="plus" onclick="pressFlow(2)">+2</button>
</div>
<div class="row">
<button class="minus" onclick="pressFlow(-1)">&minus;1</button>
<button class="minus" onclick="pressFlow(-2)">&minus;2</button>
</div>
</div>
<div class="buttons deg">
<div class="row">
<button class="plus" onclick="press('plus',%STEP1%)">+</button>
<button class="plus" onclick="press('plus',%STEP2%)">++</button>
<button class="plus" onclick="press('plus',%STEP3%)">+++</button>
</div>
<div class="row">
<button class="minus" onclick="press('minus',%STEP1%)">&minus;</button>
<button class="minus" onclick="press('minus',%STEP2%)">&minus;&minus;</button>
<button class="minus" onclick="press('minus',%STEP3%)">&minus;&minus;&minus;</button>
</div>
</div>
<div id="msg"></div>
<div id="pair"></div>
<div id="pairform" hidden><input id="pairin" placeholder="Klistra in kopplingslänken" autocomplete="off" autocapitalize="off" autocorrect="off" spellcheck="false"><button onclick="pairFromField()">Koppla</button></div>
<div class="small"><a href="#" onclick="restart();return false">Starta om enheten</a> · v%VER%</div>
<script src="/motor.js?v=%VER%"></script>
<script>
const PIN='%PIN%'; const q = PIN ? ('?pin='+PIN) : '';
/* HMAC-SHA256 in plain JS. An http:// page is not a secure context, so the
   browser's crypto.subtle is not available to it. Checked against node:crypto
   by tools/test_hmac.mjs, which reads this exact block out of both pages. */
const SHA_K=[0x428a2f98,0x71374491,0xb5c0fbcf,0xe9b5dba5,0x3956c25b,0x59f111f1,0x923f82a4,0xab1c5ed5,
0xd807aa98,0x12835b01,0x243185be,0x550c7dc3,0x72be5d74,0x80deb1fe,0x9bdc06a7,0xc19bf174,
0xe49b69c1,0xefbe4786,0x0fc19dc6,0x240ca1cc,0x2de92c6f,0x4a7484aa,0x5cb0a9dc,0x76f988da,
0x983e5152,0xa831c66d,0xb00327c8,0xbf597fc7,0xc6e00bf3,0xd5a79147,0x06ca6351,0x14292967,
0x27b70a85,0x2e1b2138,0x4d2c6dfc,0x53380d13,0x650a7354,0x766a0abb,0x81c2c92e,0x92722c85,
0xa2bfe8a1,0xa81a664b,0xc24b8b70,0xc76c51a3,0xd192e819,0xd6990624,0xf40e3585,0x106aa070,
0x19a4c116,0x1e376c08,0x2748774c,0x34b0bcb5,0x391c0cb3,0x4ed8aa4a,0x5b9cca4f,0x682e6ff3,
0x748f82ee,0x78a5636f,0x84c87814,0x8cc70208,0x90befffa,0xa4506ceb,0xbef9a3f7,0xc67178f2];
function sha256(m){
  const l=m.length, n=((l+9+63)>>6)<<6, b=new Uint8Array(n);
  b.set(m); b[l]=0x80;
  const v=new DataView(b.buffer);
  v.setUint32(n-8, Math.floor(l/0x20000000)); v.setUint32(n-4, (l*8)>>>0);
  const w=new Uint32Array(64);
  let h0=0x6a09e667,h1=0xbb67ae85,h2=0x3c6ef372,h3=0xa54ff53a,h4=0x510e527f,h5=0x9b05688c,h6=0x1f83d9ab,h7=0x5be0cd19;
  for(let i=0;i<n;i+=64){
    for(let t=0;t<16;t++) w[t]=v.getUint32(i+t*4);
    for(let t=16;t<64;t++){
      const x=w[t-15], y=w[t-2];
      const s0=((x>>>7)|(x<<25))^((x>>>18)|(x<<14))^(x>>>3);
      const s1=((y>>>17)|(y<<15))^((y>>>19)|(y<<13))^(y>>>10);
      w[t]=(w[t-16]+s0+w[t-7]+s1)|0;
    }
    let a=h0,c=h2,d=h3,e=h4,f=h5,g=h6,h=h7,bb=h1;
    for(let t=0;t<64;t++){
      const S1=((e>>>6)|(e<<26))^((e>>>11)|(e<<21))^((e>>>25)|(e<<7));
      const t1=(h+S1+((e&f)^(~e&g))+SHA_K[t]+w[t])|0;
      const S0=((a>>>2)|(a<<30))^((a>>>13)|(a<<19))^((a>>>22)|(a<<10));
      const t2=(S0+((a&bb)^(a&c)^(bb&c)))|0;
      h=g; g=f; f=e; e=(d+t1)|0; d=c; c=bb; bb=a; a=(t1+t2)|0;
    }
    h0=(h0+a)|0; h1=(h1+bb)|0; h2=(h2+c)|0; h3=(h3+d)|0; h4=(h4+e)|0; h5=(h5+f)|0; h6=(h6+g)|0; h7=(h7+h)|0;
  }
  const o=new Uint8Array(32), ov=new DataView(o.buffer);
  [h0,h1,h2,h3,h4,h5,h6,h7].forEach(function(x,i){ ov.setUint32(i*4, x>>>0); });
  return o;
}
function hmacHex(key, msg){
  const enc=new TextEncoder();
  let k=enc.encode(key); if(k.length>64) k=sha256(k);
  const ip=new Uint8Array(64), op=new Uint8Array(64);
  for(let i=0;i<64;i++){ const x=i<k.length?k[i]:0; ip[i]=x^0x36; op[i]=x^0x5c; }
  const m=enc.encode(msg), inner=new Uint8Array(64+m.length); inner.set(ip); inner.set(m,64);
  const outer=new Uint8Array(96); outer.set(op); outer.set(sha256(inner),64);
  let s=''; sha256(outer).forEach(function(x){ s+=(x<16?'0':'')+x.toString(16); });
  return s;
}
/* ---- access ----
   With the control key in force (AUTH), every request that turns or changes
   something carries an HMAC over a one-time nonce; watching needs nothing.
   The key reaches this phone ONCE, through a pairing link ending in #k=…:
   read here, kept in this browser's storage, and removed from the address
   bar. Behind #, it is never sent over the network and never logged. */
const AUTH=%AUTH%;
let KEY='';
let pairingLink=null;   // a key from #k=, not yet accepted — see checkPairing()
/* A #k= in the address, taken out of it at once. True if it is a key to try.
   Run at load AND on hashchange: a link opened again in a tab that already
   shows this page is only a hash change, no reload — nothing was checked and
   the key stayed in the address bar. */
function readPairingLink(){
  // The whole value after k=, decoded: a key with characters outside
  // [0-9A-Za-z_-] must not be cut short and stored wrong without a sign.
  const m=location.hash.match(/[#&]k=([^&]+)/);
  if(!m) return false;
  let k; try{ k=decodeURIComponent(m[1]); }catch(e){ k=m[1]; }
  try{ history.replaceState(null,'',location.pathname+location.search); }catch(e){}
  if(k===KEY) return false;
  // Not stored yet: any link — a mistyped one, or one sent by anyone to
  // replace her working key with junk (the device name is public) — would
  // otherwise unpair her with no sign. The device says first.
  pairingLink=k;
  return true;
}
try{ KEY=localStorage.getItem('ev_key')||''; }catch(e){}
readPairingLink();
window.addEventListener('hashchange', ()=>{ if(readPairingLink()){ setMode(); checkPairing(); } });
const paired=()=>!AUTH || KEY!=='';
/* fetch() for anything that turns or changes. opts carries an abort signal.
   A refusal carries res.why: 'key' (this phone's key is wrong — only then is
   a new pairing link the answer) or 'nonce' (another phone or the control
   panel got in first, twice — trying again is). */
async function ctl(path, params, opts, key){
  const p=params||'', k=key===undefined ? KEY : key;
  if(!AUTH) return fetch(path+(p?'?'+p:'')+(q?(p?'&':'?')+q.slice(1):''), opts);
  // Twice at most: a refusal for the NONCE (another phone got in first, or the
  // device restarted) is fixed by a fresh one; one for the key is not.
  for(let i=0;;i++){
    const nj=await (await fetch('/api/nonce', opts)).json();
    const qs=(p?p+'&':'')+'n='+nj.n;
    const res=await fetch(path+'?'+qs+'&h='+hmacHex(k, path+'?'+qs), opts);
    if(res.status!==403) return res;
    res.why=await res.clone().json().then(j=>j.why).catch(()=>'key');
    if(res.why!=='nonce' || i>=1) return res;
  }
}
/* A key refusal also clears the pairing line: "Telefonen är kopplad" must not
   stand next to "not approved". */
let keyRefused=false;   // the device has refused this phone's key: offer the field
function refusedText(res){
  if(res.why==='nonce') return RACE;
  const p=document.getElementById('pair'); if(p) p.textContent='';
  keyRefused=true;
  return REFUSED;
}
/* The same pairing as a #k= link, from a pasted link or a bare key — the way
   in for a home-screen web app, which has its own storage and no address bar.
   checkPairing() asks the device before anything is stored. */
function pairFromField(){
  const f=document.getElementById('pairin'), v=f.value.trim();
  const m=v.match(/[#&]k=([^&\s]+)/);
  let k=m ? m[1] : v;
  try{ k=decodeURIComponent(k); }catch(e){}
  if(!k) return;
  f.value='';
  pairingLink=k;
  setMode();
  checkPairing();
}
/* A key from a pairing link is taken only if the device accepts it: a signed
   read of /api/steg, which changes nothing. Refused: the link is wrong, and
   whatever key this phone had stays. No answer: a first pairing is kept (a
   wrong one shows itself at the first press); a second one is not, because it
   would replace a key that works. */
async function checkPairing(){
  if(pairingLink===null) return;
  // With the lock compiled out there is nothing to ask, and the key is kept
  // as before 1.12.5: pairing her phone before a lock-on build is flashed is
  // how the lock is meant to be turned on.
  if(!AUTH){ KEY=pairingLink; try{ localStorage.setItem('ev_key',KEY); }catch(e){} pairingLink=null; return; }
  // Its own line: #msg is rewritten by every analysed frame, and this outcome
  // has to stay readable — a refused link otherwise shows nothing at all.
  const k=pairingLink, m=document.getElementById('pair'), had=KEY!=='';
  let res=null;
  try{
    const ac=new AbortController(), t=setTimeout(()=>ac.abort(),6000);
    try{ res=await ctl('/api/steg','',{signal:ac.signal},k); }finally{ clearTimeout(t); }
  }catch(e){}
  if(res && res.status===403 && res.why==='key'){
    m.textContent='Kopplingslänken godtogs inte av enheten'+(had?' – den tidigare kopplingen gäller fortfarande.':'.');
  }else if(res && res.ok || !had){
    KEY=k; try{ localStorage.setItem('ev_key',KEY); }catch(e){}
    if(res && res.ok) keyRefused=false;
    // Only a key the device accepted is called paired. Kept unconfirmed, it
    // says so, and a key refusal at the first press clears this line.
    m.textContent = res && res.ok ? 'Telefonen är kopplad.'
      : 'Kopplingslänken är sparad, men enheten kunde inte bekräfta den ännu – första trycket visar om den stämmer.';
  }else{
    m.textContent='Kunde inte pröva kopplingslänken just nu – öppna den igen om en stund.';
  }
  pairingLink=null;
  setMode();
}
const REFUSED='Den här telefonen är inte godkänd för att styra – be om en ny kopplingslänk.';
const RACE='Någon annan styrde samtidigt – tryck igen.';
/* A timeout is not "no contact": the device may have taken the press and
   turned the knob before the reply was lost (a slow frame on 2.4 GHz holds its
   single web task for seconds). Pressing again blind would turn it twice. */
/* #msg carries two kinds of text: what the analysis says about the current
   frame (rewritten every second) and what happened to her last tap. The
   second must stay long enough to be read — "look at the picture before you
   press again" wiped within a second is the same as not said, and she presses
   again. So a tap's outcome holds the line for 12 s against the frame loop. */
let msgHold=0;
function note(t){ document.getElementById('msg').textContent=t; msgHold = t ? Date.now()+12000 : 0; }
function frameMsg(t){ if(Date.now()>=msgHold) document.getElementById('msg').textContent=t; }
const UNSURE='Svaret dröjde – osäkert om ratten vreds. Titta på bilden innan du trycker igen.';
const cv=document.getElementById('cv'), ctx=cv.getContext('2d',{willReadFrequently:true});
let lastFrameAt=Date.now(), lastAnalysis=0, refReady=false;
// The machine this firmware was built for. Compiled in, never chosen here.
// Guarded, like everything below that touches the engine: if /motor.js did not
// load, the picture and the buttons must still work.
let presetError='', loadError='';
try{ usePreset('%PRESET%'); }catch(e){ if(typeof usePreset==='function') presetError='Avläsningen är felinställd i den här versionen. Läs av bilden.'; }
(typeof loadRef==='function' ? loadRef() : Promise.reject(new Error('no engine')))
  .then(()=>{refReady=true})
  .catch(()=>{ loadError=presetError ||
      'Referensbilden kunde inte läsas in. Bilden visas, men inget värde kan beräknas.';
    sayLoadError(); });
/* Why there is no number, put on the message line whenever it is empty: the
   stale-picture timer clears it, and a reason that vanishes after one wifi
   hiccup leaves her with a blank. Never over other text — press() and
   restart() say things she must get to read. */
function sayLoadError(){
  show('Ingen avläsning','','none');
  const m=document.getElementById('msg'); if(!m.textContent) m.textContent=loadError;
}

// Same transform the control panel uses; the calibration is bound to it.
function orient(img){
  const t=document.createElement('canvas');
  t.width=img.height; t.height=img.width;
  // willReadFrequently: analyse() reads this canvas now, not the visible one.
  const tx=t.getContext('2d',{willReadFrequently:true});
  tx.translate(t.width/2,t.height/2);
  tx.scale(-1,1);
  tx.rotate(270*Math.PI/180);
  tx.drawImage(img,-img.width/2,-img.height/2);
  return t;
}
function show(text,unit,cls){
  const el=document.getElementById('flow');
  el.className=cls||'';
  el.innerHTML=text+(unit?'<small> '+unit+'</small>':'');
}
// Stamped with the REQUEST time: on 2.4 GHz a picture can take seconds to
// arrive, and one taken while the ball still moved must not count as settled.
function nextFrame(){ const i=new Image(), asked=Date.now(); i.onload=()=>{ frame(i, asked); setTimeout(nextFrame,250); };
  i.onerror=()=>setTimeout(nextFrame,1000); i.src='/bild?t='+asked; }
/* What she SEES is the meter alone: the preset's VIEW_* crop of the
   oriented frame (the EverFlo preset explains its numbers). An uncalibrated
   preset has none and shows the whole frame, which is what aiming a camera at
   a new machine needs.

   The ANALYSIS still gets the whole 480x640 frame — the crop is display only,
   so no band, no registration and no calibration constant is touched. Cutting
   this close leaves little margin if the camera slides sideways, and that is
   the right trade: past 30 px (SHIFT_X) the engine refuses the reading anyway, and
   the control panel still shows the full frame for working out why. */
// No ?? here: this page must parse on older Safari (before 13.4) too.
const CROP_X=(typeof VIEW_X!=='undefined' && VIEW_X!=null) ? VIEW_X : 0;
const CROP_W=(typeof VIEW_W!=='undefined' && VIEW_W!=null) ? VIEW_W : 480;
// Vertical too since 1.11.2: the Platinum's meter fills only part of the
// height, and cropping to it is what makes it large on her phone.
const CROP_Y=(typeof VIEW_Y!=='undefined' && VIEW_Y!=null) ? VIEW_Y : 0;
const CROP_H=(typeof VIEW_H!=='undefined' && VIEW_H!=null) ? VIEW_H : 640;
cv.width=CROP_W; cv.height=CROP_H;
function frame(img, asked){
  lastFrameAt=Date.now();
  const t=orient(img);
  ctx.setTransform(1,0,0,1,0,0);
  ctx.drawImage(t, CROP_X,CROP_Y,CROP_W,CROP_H, 0,0,CROP_W,CROP_H);
  // Once a second is plenty: the ball moves slowly and analysis costs
  // real work on a phone.
  if(loadError){ sayLoadError(); return; }
  if(!refReady || Date.now()-lastAnalysis<1000) return;
  lastAnalysis=Date.now();
  let r,b;
  try{ r=analyze(t.getContext('2d').getImageData(0,0,480,640)); b=judge(r); }
  catch(e){ show('Ingen avläsning','','none');
             frameMsg(''); noteReading(null,0); shown='none'; setMode(); return; }
  if(!b.ok){ show(b.title,'','none'); frameMsg(b.reason); noteReading(null,0); shown='none'; setMode(); return; }
  frameMsg('');
  // Only a number is something to step from: not Max, not the bottom state,
  // and not one the page itself marks uncertain (extrapolated).
  const steppable=!b.maxState && !b.bottomState && !b.extrapolated;
  noteReading(steppable ? r.flow : null, asked||Date.now());
  shown = steppable ? 'number' : 'state';
  setMode();
  if(b.maxState) show(b.label,'över skalans slut','warn');
  else if(b.bottomState) show(b.label,'L/min','warn');
  else show(r.flow.toFixed(1),'L/min'+(b.extrapolated?' (osäkert)':''));
}
// A frame that stopped updating looks exactly like a live one. Without this
// warning the operator can believe they see the present and press blind.
setInterval(()=>{
  const age=Math.round((Date.now()-lastFrameAt)/1000);
  document.getElementById('camwrap').classList.toggle('stale', age>=5);
  if(age>=5){
    document.getElementById('staleAge').textContent=
      'Senaste bild för '+age+' sekunder sedan. Tryck inte förrän bilden är tillbaka.';
    show('–','L/min','none');   // never leave a stale number looking current
    frameMsg('');
    noteReading(null,0); shown='none';
  }
  setMode();
}, 1000);
nextFrame();
checkPairing();
// Tells the device someone is looking, so the lamp over the meter stays lit
// steadily. /bild alone would blink it off during a network hiccup, and it
// stops within a minute of the page being closed or the phone locked.
function pulse(){ if(document.visibilityState==='visible') fetch('/api/ui-pulse').catch(()=>{}); }
pulse(); setInterval(pulse,5000);
document.addEventListener('visibilitychange',pulse);
const allButtons=()=>document.querySelectorAll('.buttons button');
async function press(op,deg){
  pressing=true;
  allButtons().forEach(b=>b.disabled=true);
  note('');
  // 6 s, like pressFlow: a unit that goes dark mid-request must not keep every
  // button on her page disabled (2026-08-15: never locked). It covers the
  // nonce, a possible retry and the move itself.
  const ac=new AbortController(), tm=setTimeout(()=>ac.abort(),6000);
  try{
    const res = await ctl('/api/'+op, 'steg='+deg, {signal:ac.signal});
    const j = await res.json();
    if(res.status===403) note(refusedText(res));
    else if(!j.ok) note('Motorn är upptagen – vänta');
  }catch(e){ note(e.name==='AbortError' ? UNSURE : 'Ingen kontakt'); }
  finally{ clearTimeout(tm); }
  // The reply comes when the motor has STOPPED. From here the next flow step
  // needs a reading of the settled ball, taken after that moment — compared
  // with another from after it, never with one from before the press.
  pending=null; motorStopped=Date.now(); prevNum=null;
  pressing=false;
  allButtons().forEach(b=>b.disabled=false);
  setMode();
}
/* ---- flow steps ----
   The buttons say "+1 / +2" when there is something to step FROM: a
   (the +0,2 pair was dropped 2026-09-30 on the operator's judgement: too
   unreliable — a step that small sits inside the reading's own error and the
   knob's slack) — 
   measured knob table for this machine (KNOB in its preset) and a number
   read within the last 3 s. Otherwise the fixed-degree buttons, with a line
   saying so — never locked (2026-08-15: a remote control that locks when
   something is wrong is gone exactly when it is needed). The 3 s also keeps
   the buttons from flickering between the two sets on one refused frame.
   After a flow press the next one steps from where that press was heading,
   not from the old reading, until the ball has had time to settle. */
/* When is the ball still? The press reply comes when the MOTOR has stopped
   (the firmware answers after the move), so only the float's own settling is
   left, and that is measured, not assumed: two readings in a row, both
   requested after the motor stopped, within 0.1 L/min of each other. Usually
   1-2 s. A turn by hand looks the same: while the ball moves there is no
   base; once it is still, the new level is the base — the app need not have
   made the turn. (Which WAY a hand turned the knob is not tracked: see the
   backlash note in pressFlow.) */
let good=null, lastGood=null, pending=null, pressing=false, shown='none', motorStopped=0, prevNum=null, moving=false;
/* good is what a step may be sized FROM: a settled reading, and nothing the
   moment a frame is refused, the picture goes stale, or a state (Max, the
   bottom) is shown. lastGood only keeps the flow buttons on screen through
   such gaps (8 s), so they do not swap under her finger; a tap in a gap is
   told to wait instead of being sized from an old number. */
function noteReading(flow, asked){
  if(flow===null){ prevNum=null; good=null; return; }   // no number: nothing to step from
  if(asked<motorStopped){ return; }              // taken while the motor still turned
  if(prevNum && Math.abs(flow-prevNum.flow)<0.1){
    good={flow, at:asked}; lastGood=good; moving=false;
    if(pending && asked>=motorStopped) pending=null;            // the settled ball now says where it is
  } else if(prevNum) moving=true;
  prevNum={flow, asked};
}
const hasKnob=()=>typeof knobPlan==='function' && typeof KNOB!=='undefined' && KNOB!=null;
const shownFlow=()=>document.body.classList.contains('flowmode');
// Hysteresis in flow and in time: the flow buttons appear on a reading at
// most 3 s old inside the table, and once shown they stay through 8 s of
// refused frames and 0.2 past its ends — so the button under her finger does
// not change meaning on a bob or one bad frame.
const margin=()=>shownFlow() ? 0.2 : 0;
const holdMs=()=>shownFlow() ? 8000 : 3000;
// What a flow press would step from right now: where the last flow press was
// heading until the settled ball says otherwise (6 s at most), else the
// CURRENT settled reading (good — cleared by any refused or stale frame).
// Only if the knob table covers it, by the same test knobPlan makes.
function stepBase(){
  if(!hasKnob()) return null;
  const f = (pending && Date.now()<pending.until) ? pending.target
          : (good && good.at>=motorStopped && Date.now()-good.at<3000) ? good.flow : null;
  return f!==null && knobCovers(f, margin()) ? f : null;
}
// Whether the flow buttons are SHOWN: a step base now, or one within the
// hold (3 s to appear, 8 s to stay) — so a gap does not swap the buttons.
function showFlow(){
  if(!hasKnob()) return false;
  if(stepBase()!==null) return true;
  return !!(lastGood && lastGood.at>=motorStopped && Date.now()-lastGood.at<holdMs() && knobCovers(lastGood.flow, margin()));
}
function setMode(){
  // Both ways: a first pairing finishes AFTER this has run with no key, and a
  // class only ever added kept her buttons hidden until a reload (1.12.5).
  document.body.classList.toggle('unpaired', !paired());
  document.getElementById('pairform').hidden = !AUTH || pairingLink!==null || (paired() && !keyRefused);
  if(!paired()){
    document.getElementById('mode').textContent = pairingLink!==null
      ? 'Prövar kopplingslänken …'
      : 'Den här telefonen är inte kopplad till fjärrkontrollen – klistra in kopplingslänken nedan. Bilden och flödet visas ändå.';
    return;
  }
  if(pressing) return;                 // no switching under her finger
  const on=showFlow();
  document.body.classList.toggle('flowmode', on);
  document.getElementById('mode').textContent = !hasKnob() || on || Date.now()-motorStopped<3000 ? ''
    : shown==='none' ? 'Ingen avläsning – knapparna vrider ett fast steg.'
    : 'Utanför knapparnas område – de vrider ett fast steg.';
}
async function pressFlow(delta){
  // Re-checked at the tap, not trusted from the last mode switch: that ran up
  // to a second ago, and the reading may be too old by now.
  const from=stepBase();
  if(from===null){ note('Ingen avläsning just nu – vänta en sekund, eller använd knapparna med fast steg.'); setMode(); return; }
  // Buttons stay put while the ball moves (no switching under her finger),
  // but a step is not sized from a ball in motion.
  if(moving && !(pending && Date.now()<pending.until)){ note('Bollen rör sig – vänta ett ögonblick.'); return; }
  if(pressing) return;
  // Locked from here, BEFORE the status request below: a second tap while it
  // is out (a double tap, or a repeat on slow wifi) would otherwise size its
  // own step from the same reading and turn the knob twice.
  pressing=true;
  allButtons().forEach(b=>b.disabled=true);
  const release=()=>{ pressing=false; allButtons().forEach(b=>b.disabled=false); };
  // Which way the knob was last turned decides whether the slack is paid —
  // the direction of the device's own last move (any page, any phone). A turn
  // by hand it cannot know, and guessing it from the reading proved fragile;
  // knobPlan() leaves the slack out wherever paying it with no slack there
  // would carry the flow past 1 or the top. Unknown: no backlash — short is
  // the safe error.
  let lastDir=null;
  if(BACKLASH>0){
    try{
      const ac0=new AbortController(), t0=setTimeout(()=>ac0.abort(),2000);
      const s0=await (await fetch('/api/status',{signal:ac0.signal})).json(); clearTimeout(t0);
      lastDir = s0.dir>0 ? 'plus' : s0.dir<0 ? 'minus' : null;
    }catch(e){}
  }
  const p=knobPlan(from, delta, lastDir, margin());
  if(!p){ release(); setMode(); return; }         // the degree buttons come back, with the line saying why
  const sv=(x)=>x.toFixed(1).replace('.',',');
  if(p.atLimit){ release(); note(delta>0 ? 'Redan vid det högsta flödet knapparna går till ('+sv(p.hi)+' L/min).'
                                         : 'Redan vid det lägsta flödet knapparna går till ('+sv(p.lo)+' L/min).'); return; }
  // Under the motor's smallest step (4°) this step is not something it can
  // make here without overshooting it: nothing turns.
  if(p.deg<4){ release(); note('Steget är för litet för motorn här – välj ett större.'); return; }
  // One press turns at most 180°: split evenly, rounding down.
  const n=Math.ceil(p.deg/180), each=Math.floor(p.deg/n);
  note('');
  let done=0;
  try{
    for(let i=0;i<n;i++){
      // 6 s: a hung request must not keep every button on her page disabled
      // (2026-08-15: never locked), and the budget covers the nonce, a
      // possible retry and the move — 4 s could run out after the knob had
      // already turned.
      const ac=new AbortController(), tm=setTimeout(()=>ac.abort(),6000);
      try{
        const res = await ctl('/api/'+p.op, 'steg='+each, {signal:ac.signal});
        const j = await res.json();
        if(res.status===403){ note(refusedText(res)); break; }
        if(!j.ok){ note('Motorn är upptagen – vänta'); break; }
      }finally{ clearTimeout(tm); }
      done++;
    }
  }catch(e){ note(e.name==='AbortError' ? UNSURE : 'Ingen kontakt'); }
  // The last reply came when the motor stopped. A step that fully happened is
  // somewhere to step on from until the settled ball speaks; anything less
  // waits for that reading.
  motorStopped=Date.now(); prevNum=null;
  if(done===n) pending={target:p.target, until:Date.now()+6000};
  else pending=null;
  release();
  setMode();
}
async function restart(){
  if(!confirm('Starta om enheten? Bilden återkommer inom en minut.'))return;
  try{ const res=await ctl('/api/omstart'); if(res.status===403){ note(refusedText(res)); return; } }catch(e){}
  note('Startar om...');
}
</script></body></html>
)HTML";

bool pinOK(httpd_req_t *req) {
  if (strlen(WEB_PIN) == 0) return true;
  char buf[256]; char val[16] = "";
  if (httpd_req_get_url_query_str(req, buf, sizeof(buf)) == ESP_OK)
    httpd_query_key_value(buf, "pin", val, sizeof(val));
  return strcmp(val, WEB_PIN) == 0;
}

/* ---- the control key ----
   Challenge-response, because on an open or shared wifi everyone on the
   network can read the traffic: a key sent along would be captured and
   replayed. Instead the client fetches a one-time nonce (/api/nonce) and
   sends HMAC-SHA256(key, "<path>?<query up to &h=>"), with the nonce inside
   that query. The device checks the HMAC and burns the nonce, so a captured
   request is worth exactly nothing: its nonce is spent, and the key itself
   never crosses the network.

   Nonces live 60 s and are used once (see below). All port-80 handlers run
   on one task, so the counters need no lock. No lockout on failures: a 128-bit key
   is not guessed, and a lockout would be a way for anyone on the network to
   take her buttons away. Failures are logged, at most one line per 10 s. */
/* Stateless nonces, so that fetching them cannot starve anyone: a table of
   issued nonces could be flushed by anyone on the network asking for them in
   a loop, and her next press would find hers gone. A nonce here is
   issue-time (4 bytes) | counter (4) | tag (8), the tag an HMAC under a key
   drawn at boot — so the device can tell one it issued, and how old it is,
   without remembering it. Accepted once: its counter must be above the last
   one used. Two controllers racing each other can lose one press to that,
   and a retry fixes it; flooding the endpoint only advances the counter. */
static uint8_t nonceSecret[16];
static uint32_t nonceCounter = 0, nonceLastUsed = 0;
static bool nonceReady = false;
static void nonceTag(uint32_t t, uint32_t c, uint8_t out[8]) {
  uint8_t msg[8] = {(uint8_t)(t >> 24), (uint8_t)(t >> 16), (uint8_t)(t >> 8), (uint8_t)t,
                    (uint8_t)(c >> 24), (uint8_t)(c >> 16), (uint8_t)(c >> 8), (uint8_t)c};
  uint8_t mac[32];
  mbedtls_md_hmac(mbedtls_md_info_from_type(MBEDTLS_MD_SHA256), nonceSecret, sizeof(nonceSecret), msg, 8, mac);
  memcpy(out, mac, 8);
}
static unsigned long lastAuthLog = 0;
/* Why the last check failed, for the reply: "nonce" (lost a race, expired,
   the device restarted — a retry with a fresh one fixes it) or "key" (wrong
   key or a malformed request — a retry does not). */
static const char *authWhy = "key";

esp_err_t h_nonce(httpd_req_t *req) {
  if (!nonceReady) { esp_fill_random(nonceSecret, sizeof(nonceSecret)); nonceReady = true; }
  uint32_t t = millis(), c = ++nonceCounter;
  /* The counter is advanced by anyone (this endpoint is open), and after 2^32
     requests it would wrap below nonceLastUsed and refuse every signed
     request until a reboot. A fresh secret voids every older nonce, so the
     count can start over. */
  if (c == 0) { esp_fill_random(nonceSecret, sizeof(nonceSecret)); nonceLastUsed = 0; c = ++nonceCounter; }
  uint8_t tag[8]; nonceTag(t, c, tag);
  char hex[33];
  snprintf(hex, sizeof(hex), "%08lx%08lx", (unsigned long)t, (unsigned long)c);
  for (int i = 0; i < 8; i++) sprintf(hex + 16 + 2 * i, "%02x", tag[i]);
  char b[64]; snprintf(b, sizeof(b), "{\"n\":\"%s\"}", hex);
  httpd_resp_set_type(req, "application/json");
  httpd_resp_set_hdr(req, "Access-Control-Allow-Origin", "*");
  httpd_resp_set_hdr(req, "Cache-Control", "no-store");
  return httpd_resp_send(req, b, HTTPD_RESP_USE_STRLEN);
}

static void authLog(const char *why) {
  if (millis() - lastAuthLog < 10000) return;
  lastAuthLog = millis();
  logLine(String("Control refused: ") + why);
}

bool authOK(httpd_req_t *req) {
#if !CONTROL_AUTH
  return pinOK(req);
#else
  authWhy = "key";                         // until a nonce check says otherwise
  // req->uri is the whole request target, query included, exactly as sent.
  const char *uri = req->uri;
  const char *h = strstr(uri, "&h=");
  if (!h || strlen(h + 3) != 64 || strchr(h + 3, '&')) { authLog("no or malformed h"); return false; }
  const char *qm = strchr(uri, '?');
  if (!qm || qm > h) { authLog("no query"); return false; }
  char query[256];
  size_t qlen = h - (qm + 1);
  if (qlen >= sizeof(query)) { authLog("query too long"); return false; }
  memcpy(query, qm + 1, qlen); query[qlen] = 0;
  char n[40] = "";
  if (httpd_query_key_value(query, "n", n, sizeof(n)) != ESP_OK || strlen(n) != 32) { authLog("no nonce"); return false; }
  if (!nonceReady) { authWhy = "nonce"; authLog("no nonce issued since boot"); return false; }
  uint32_t t = strtoul(String(n).substring(0, 8).c_str(), NULL, 16);
  uint32_t c = strtoul(String(n).substring(8, 16).c_str(), NULL, 16);
  uint8_t tag[8]; nonceTag(t, c, tag);
  char tagHex[17]; for (int i = 0; i < 8; i++) sprintf(tagHex + 2 * i, "%02x", tag[i]);
  uint8_t td = 0; for (int i = 0; i < 16; i++) td |= (uint8_t)(tolower(n[16 + i]) ^ tagHex[i]);
  if (td) { authWhy = "nonce"; authLog("nonce not issued here"); return false; }
  if ((uint32_t)(millis() - t) >= 60000) { authWhy = "nonce"; authLog("nonce expired"); return false; }
  if (c <= nonceLastUsed) { authWhy = "nonce"; authLog("nonce already used"); return false; }
  uint8_t mac[32];
  mbedtls_md_hmac(mbedtls_md_info_from_type(MBEDTLS_MD_SHA256),
                  (const uint8_t *)CONTROL_KEY, strlen(CONTROL_KEY),
                  (const uint8_t *)uri, h - uri, mac);
  char want[65];
  for (int i = 0; i < 32; i++) sprintf(want + 2 * i, "%02x", mac[i]);
  uint8_t diff = 0;                        // constant time: no early exit on the first wrong digit
  for (int i = 0; i < 64; i++) diff |= (uint8_t)(tolower(h[3 + i]) ^ want[i]);
  if (diff) { authWhy = "key"; authLog("wrong key"); return false; }
  // Spent only when it carried the key. A wrong signature must not advance
  // the counter: anyone can fetch a nonce, and sending junk with a newer one
  // would otherwise void the nonce her phone is about to use.
  nonceLastUsed = c;
  return true;
#endif
}
/* JSON with CORS, so the control panel (another origin) can read WHY it was
   refused rather than see a network error. */
esp_err_t authFail(httpd_req_t *req) {
  httpd_resp_set_status(req, "403 Forbidden");
  httpd_resp_set_type(req, "application/json");
  httpd_resp_set_hdr(req, "Access-Control-Allow-Origin", "*");
  char b[64]; snprintf(b, sizeof(b), "{\"ok\":false,\"auth\":false,\"why\":\"%s\"}", authWhy);
  return httpd_resp_send(req, b, HTTPD_RESP_USE_STRLEN);
}

esp_err_t sendJson(httpd_req_t *req, bool ok, int applied) {
  char b[192];
  // `steg` is what the firmware actually turned, after its own clamping, so a
  // caller asking for 180 can see it got 180 — or did not. `preset` is the
  // machine this build was made for; the control panel reads the meter with it,
  // and `buttons` are her three button sizes for that machine, which the panel
  // uses for its own buttons rather than EverFlo's 39/90/160.
  snprintf(b, sizeof(b), "{\"ok\":%s,\"lage\":%d,\"steg\":%d,\"preset\":\"" PRESET_ID "\","
           "\"buttons\":[%d,%d,%d],\"dir\":%d,\"auth\":%d}",
           ok ? "true" : "false", position, applied, DEG_PER_PRESS, STEP_MEDIUM, STEP_LARGE, (int)lastMoveDir,
           CONTROL_AUTH);
  httpd_resp_set_type(req, "application/json");
  // CORS on every JSON API, not just /api/steg. The control panel runs from
  // a different origin and today fires the motor calls no-cors, which makes
  // a 403 or a wrong host indistinguishable from success. With this header
  // it can read the reply and tell whether the press actually landed — and
  // that page can be changed from anywhere, while this firmware cannot.
  httpd_resp_set_hdr(req, "Access-Control-Allow-Origin", "*");
  return httpd_resp_send(req, b, HTTPD_RESP_USE_STRLEN);
}

esp_err_t h_index(httpd_req_t *req) {
  String s(PAGE);
  s.replace("%PIN%", CONTROL_AUTH ? "" : WEB_PIN);   // never sent when the key is in force
  s.replace("%AUTH%", CONTROL_AUTH ? "1" : "0");
  s.replace("%VER%", FW_VERSION);
  s.replace("%PRESET%", PRESET_ID);
  s.replace("%STEP1%", String(DEG_PER_PRESS));
  s.replace("%STEP2%", String(STEP_MEDIUM));
  s.replace("%STEP3%", String(STEP_LARGE));
  httpd_resp_set_type(req, "text/html; charset=utf-8");
  return httpd_resp_send(req, s.c_str(), s.length());
}
/* Optional ?steg=N on a press: use that angle for this press only, clamped,
   without disturbing the standing default. One request instead of set-then-
   press, so two phones cannot race each other into the wrong step size. */
int pressDegrees(httpd_req_t *req) {
  char buf[256]; char val[16] = "";   // room for n= and h= after steg=
  if (httpd_req_get_url_query_str(req, buf, sizeof(buf)) == ESP_OK &&
      httpd_query_key_value(buf, "steg", val, sizeof(val)) == ESP_OK) {
    char *end = NULL;
    long v = strtol(val, &end, 10);
    if (end != val && *end == '\0' && v > 0) {
      if (v < STEP_DEG_MIN) v = STEP_DEG_MIN;
      if (v > STEP_DEG_MAX) v = STEP_DEG_MAX;
      return (int)v;
    }
  }
  return stepDegrees;
}
esp_err_t h_plus(httpd_req_t *req)  { if(!authOK(req)) return authFail(req); int d=pressDegrees(req); return sendJson(req, move(+1, d), d); }
esp_err_t h_minus(httpd_req_t *req) { if(!authOK(req)) return authFail(req); int d=pressDegrees(req); return sendJson(req, move(-1, d), d); }
esp_err_t h_reset(httpd_req_t *req) { if(!authOK(req)) return authFail(req); position=0; prefs.putInt("lage",0); return sendJson(req,true,stepDegrees); }
esp_err_t h_status(httpd_req_t *req){ return sendJson(req, true, stepDegrees); }
esp_err_t h_restart(httpd_req_t *req){
  if(!authOK(req)) return authFail(req);
  sendJson(req, true, stepDegrees);
  logLine("Restart via web link");
  delay(300);
  ESP.restart();
  return ESP_OK;
}
/* Step size (degrees/press), RAM only. Same CORS as /bild. */
esp_err_t sendStepJson(httpd_req_t *req) {
  char b[96];
  snprintf(b, sizeof(b), "{\"steg\":%d,\"min\":%d,\"max\":%d,\"standard\":%d}",
           stepDegrees, STEP_DEG_MIN, STEP_DEG_MAX, DEG_PER_PRESS);
  httpd_resp_set_type(req, "application/json");
  httpd_resp_set_hdr(req, "Access-Control-Allow-Origin", "*");
  return httpd_resp_send(req, b, HTTPD_RESP_USE_STRLEN);
}
esp_err_t h_step(httpd_req_t *req) {
  if(!authOK(req)) return authFail(req);
  char buf[256]; char val[16] = "";   // room for n= and h= after v=
  if (httpd_req_get_url_query_str(req, buf, sizeof(buf)) == ESP_OK &&
      httpd_query_key_value(buf, "v", val, sizeof(val)) == ESP_OK) {
    char *end = NULL;
    long v = strtol(val, &end, 10);
    if (end != val && *end == '\0' && v >= 0) {   // invalid/negative/empty = ignore
      if (v < STEP_DEG_MIN) v = STEP_DEG_MIN;
      if (v > STEP_DEG_MAX) v = STEP_DEG_MAX;
      stepDegrees = (int)v;
      logLine(String("Step size: ") + stepDegrees + " degrees/press");
    }
  }
  return sendStepJson(req);
}
/* The detection engine, straight from flash. Kept out of the page string
   because h_index copies that into a String on every request and ~90 kB of
   engine would not fit in heap.

   Cached hard AND versioned, and both halves are load-bearing. The engine is
   ~90 kB over 2.4 GHz wifi, so refetching it every page load is expensive —
   hence a year and immutable. But it DOES change, on every flash, and
   immutable means the browser never revalidates. So the page asks for
   /motor.js?v=<FW_VERSION> and a version bump is what busts the cache.

   This bit me on 2026-08-16: the engine was recalibrated three times while
   FW_VERSION stayed at 1.8.9, and a phone that had already cached the old
   engine would have kept refusing to read after a flash that was in fact
   fine. Bump FW_VERSION on every engine change, not just firmware changes. */
esp_err_t h_engine(httpd_req_t *req) {
  httpd_resp_set_type(req, "application/javascript; charset=utf-8");
  httpd_resp_set_hdr(req, "Cache-Control", "public, max-age=31536000, immutable");
  return httpd_resp_send(req, BALLDETECTOR_JS, HTTPD_RESP_USE_STRLEN);
}
/* "Someone has this page open right now." Every UI that shows the picture
   calls it every 20 s while it is visible.

   /bild alone would nearly do the job, but its window is 3 s and the pages
   back off a second when a request fails — so a wifi hiccup would blink the
   light off and on over the meter she is trying to read. A minute of slack
   costs nothing and makes the light steady.

   No PIN check, deliberately: it changes no device state, the control panel
   calls it cross-origin and has no way to know a PIN, and the worst it can
   do is keep a lamp on for a minute. /api/status is open for the same
   reason, while /api/steg — which does change state — is not. */
esp_err_t h_uipulse(httpd_req_t *req) {
  lastUiPulseAt = millis();
  ledApply();               // no settle wait: nothing is being captured here
  httpd_resp_set_type(req, "application/json");
  httpd_resp_set_hdr(req, "Access-Control-Allow-Origin", "*");
  return httpd_resp_send(req, "{\"ok\":true}", HTTPD_RESP_USE_STRLEN);
}
/* Starts the colour cycle and answers at once — see ledTestUpdate(). Setting
   the flag last means loop() cannot catch the sequence half-armed. */
esp_err_t h_ledtest(httpd_req_t *req) {
  if(!authOK(req)) return authFail(req);
  ledTestRunning = true;    // the only cross-task variable the test has; the
                            // step and its clock belong to loop()
  logLine("LED test: red, green, blue, white");
  httpd_resp_set_type(req, "application/json");
  httpd_resp_set_hdr(req, "Access-Control-Allow-Origin", "*");
  return httpd_resp_send(req, "{\"ok\":true}", HTTPD_RESP_USE_STRLEN);
}
/* Ask the cloud for an armed build now rather than within 15 minutes — see
   fwCheckRequested. Answers at once; the check runs from loop(). */
volatile bool fwCheckRequested = false;   // read and cleared in loop()
esp_err_t h_fwcheck(httpd_req_t *req) {
  if(!authOK(req)) return authFail(req);
  fwCheckRequested = true;
  logLine("Firmware check requested via /api/fw-check");
  httpd_resp_set_type(req, "application/json");
  httpd_resp_set_hdr(req, "Access-Control-Allow-Origin", "*");
  return httpd_resp_send(req, "{\"ok\":true}", HTTPD_RESP_USE_STRLEN);
}
/* The light, adjustable while you watch what it does to the reading.
   GET returns the state; ?on=0|1, ?level=0..255 and ?rgb=RRGGBB set it.

   RAM only, like /api/steg: `standard` in the reply is the compiled LED_LEVEL
   the device returns to on any restart. That is the safety net for the whole
   endpoint — the calibration is bound to one lighting, so a unit left in a
   test light reads wrong, and here the way out is a power blip rather than a
   trip. The control panel says so out loud when the values differ.

   PIN-checked: unlike /api/ui-pulse this changes device state. */
esp_err_t h_light(httpd_req_t *req) {
  if (!authOK(req)) return authFail(req);
  char buf[256]; char val[16] = "";   // room for n= and h= after the settings
  /* Parsed into locals first, then moved across under the mutex in one go.
     Assigning straight to the globals would let loop()'s ledApply() land
     between the level and the tint and drive the pixel with half of each. It
     would correct itself on the next call, but "it converges" is not the same
     as "it is right", and the fix is four lines. */
  bool     newOn    = lightEnabled;
  int      newLevel = lightLevel;
  uint8_t  nr = lightR, ng = lightG, nb = lightB;
  bool changed = false;
  if (httpd_req_get_url_query_str(req, buf, sizeof(buf)) == ESP_OK) {
    // Only "0" and "1". An empty ?on= must not read as "off": every other
    // parameter here ignores junk, and a stray & turning the light out is
    // exactly the kind of surprise this endpoint should not have.
    if (httpd_query_key_value(buf, "on", val, sizeof(val)) == ESP_OK &&
        (strcmp(val, "0") == 0 || strcmp(val, "1") == 0)) {
      newOn = (val[0] == '1');
      changed = true;
    }
    if (httpd_query_key_value(buf, "level", val, sizeof(val)) == ESP_OK) {
      char *end = NULL;
      long v = strtol(val, &end, 10);
      if (end != val && *end == '\0' && v >= 0) {      // junk = ignored, as /api/steg
        if (v > 255) v = 255;
        newLevel = (int)v;
        changed = true;
      }
    }
    if (httpd_query_key_value(buf, "rgb", val, sizeof(val)) == ESP_OK &&
        strlen(val) == 6) {
      char *end = NULL;
      long v = strtol(val, &end, 16);
      if (end != val && *end == '\0' && v >= 0) {
        nr = (v >> 16) & 0xFF; ng = (v >> 8) & 0xFF; nb = v & 0xFF;
        changed = true;
      }
    }
  }
  if (changed) {
    if (ledMutex) xSemaphoreTake(ledMutex, portMAX_DELAY);
    lightEnabled = newOn; lightLevel = newLevel;
    lightR = nr; lightG = ng; lightB = nb;
    ledDirty = true;      // an on/off change would move ledLit anyway; a level
                          // or tint change is only visible through this flag
    if (ledMutex) xSemaphoreGive(ledMutex);
  }
  ledApply();
  if (changed) {
    // In the log because a light that is not the compiled one explains a week
    // of odd readings, and /log is where that question gets asked.
    char l[96];
    snprintf(l, sizeof(l), "Light: %s, level %d, rgb %02x%02x%02x",
             lightEnabled ? "on" : "off", lightLevel,
             (int)lightR, (int)lightG, (int)lightB);
    logLine(l);
  }
  char b[160];
  snprintf(b, sizeof(b),
           "{\"on\":%s,\"level\":%d,\"rgb\":\"%02x%02x%02x\","
           "\"standard\":%d,\"always\":%s}",
           lightEnabled ? "true" : "false", lightLevel,
           (int)lightR, (int)lightG, (int)lightB,
           LED_LEVEL, LED_ALWAYS_ON ? "true" : "false");
  httpd_resp_set_type(req, "application/json");
  httpd_resp_set_hdr(req, "Access-Control-Allow-Origin", "*");
  return httpd_resp_send(req, b, HTTPD_RESP_USE_STRLEN);
}
esp_err_t h_log(httpd_req_t *req) {
  String s;
  for (int i = 0; i < 40; i++) {
    int k = (logIdx + i) % 40;
    if (logBuf[k].length()) { s += logBuf[k]; s += "\n"; }
  }
  httpd_resp_set_type(req, "text/plain; charset=utf-8");
  return httpd_resp_send(req, s.c_str(), s.length());
}
esp_err_t h_snapshot(httpd_req_t *req) {
  ledForCapture(LED_SETTLE_MS);   // the image content and format are untouched;
                                  // only the light it is taken in changes
  camera_fb_t *fb = esp_camera_fb_get();
  if (!fb) return httpd_resp_send_500(req);
  httpd_resp_set_type(req, "image/jpeg");
  httpd_resp_set_hdr(req, "Access-Control-Allow-Origin", "*");
  esp_err_t r = httpd_resp_send(req, (const char*)fb->buf, fb->len);
  esp_camera_fb_return(fb);
  return r;
}

/* MJPEG stream */
esp_err_t h_stream(httpd_req_t *req) {
  char part[96];
  uint32_t min_gen = ++stream_gen;   // this connection is now the only valid viewer
  httpd_resp_set_type(req, "multipart/x-mixed-replace;boundary=fr");
  httpd_resp_set_hdr(req, "Access-Control-Allow-Origin", "*");
  while (stream_gen == min_gen) {
    camera_fb_t *fb = esp_camera_fb_get();
    if (!fb) { httpd_resp_send_500(req); return ESP_FAIL; }
    size_t hl = snprintf(part, sizeof(part),
      "--fr\r\nContent-Type: image/jpeg\r\nContent-Length: %u\r\n\r\n", fb->len);
    if (httpd_resp_send_chunk(req, part, hl) != ESP_OK ||
        httpd_resp_send_chunk(req, (const char*)fb->buf, fb->len) != ESP_OK ||
        httpd_resp_send_chunk(req, "\r\n", 2) != ESP_OK) {
      esp_camera_fb_return(fb);
      break;                       // the client closed
    }
    esp_camera_fb_return(fb);
  }
  return ESP_OK;
}

void startWebServer() {
  httpd_config_t cfg = HTTPD_DEFAULT_CONFIG();
  cfg.server_port = 80;
  cfg.max_uri_handlers = 18;   // 15 registered; registration fails silently
                               // above this, so keep headroom over the count
  // Several people may watch at once — /bild is a plain one-shot request
  // with no viewer kickout, so they all get frames. The default is to
  // REFUSE a new connection once the 7 sockets are taken, which would
  // shut out whoever connects last. Purging the least recently used one
  // instead costs an evicted viewer a single frame: both pages re-request
  // continuously and heal on the next tick.
  cfg.lru_purge_enable = true;
  // max_open_sockets is deliberately left at 7. Raising it eats into the
  // same LWIP socket pool the outbound TLS connections for the health ping
  // and the image upload need.
  if (httpd_start(&ctrl_httpd, &cfg) == ESP_OK) {
    httpd_uri_t u;   // URL paths keep their Swedish names – the control panel depends on them
    u = {.uri="/",              .method=HTTP_GET, .handler=h_index,   .user_ctx=NULL}; httpd_register_uri_handler(ctrl_httpd,&u);
    u = {.uri="/api/plus",      .method=HTTP_GET, .handler=h_plus,    .user_ctx=NULL}; httpd_register_uri_handler(ctrl_httpd,&u);
    u = {.uri="/api/minus",     .method=HTTP_GET, .handler=h_minus,   .user_ctx=NULL}; httpd_register_uri_handler(ctrl_httpd,&u);
    u = {.uri="/api/nollstall", .method=HTTP_GET, .handler=h_reset,   .user_ctx=NULL}; httpd_register_uri_handler(ctrl_httpd,&u);
    u = {.uri="/api/omstart",   .method=HTTP_GET, .handler=h_restart, .user_ctx=NULL}; httpd_register_uri_handler(ctrl_httpd,&u);
    u = {.uri="/api/status",    .method=HTTP_GET, .handler=h_status,  .user_ctx=NULL}; httpd_register_uri_handler(ctrl_httpd,&u);
    u = {.uri="/api/steg",      .method=HTTP_GET, .handler=h_step,    .user_ctx=NULL}; httpd_register_uri_handler(ctrl_httpd,&u);
    u = {.uri="/motor.js",      .method=HTTP_GET, .handler=h_engine,  .user_ctx=NULL}; httpd_register_uri_handler(ctrl_httpd,&u);
    u = {.uri="/log",           .method=HTTP_GET, .handler=h_log,     .user_ctx=NULL}; httpd_register_uri_handler(ctrl_httpd,&u);
    u = {.uri="/bild",          .method=HTTP_GET, .handler=h_snapshot,.user_ctx=NULL}; httpd_register_uri_handler(ctrl_httpd,&u);
    u = {.uri="/api/ui-pulse",   .method=HTTP_GET, .handler=h_uipulse, .user_ctx=NULL}; httpd_register_uri_handler(ctrl_httpd,&u);
    u = {.uri="/api/led-test",  .method=HTTP_GET, .handler=h_ledtest, .user_ctx=NULL}; httpd_register_uri_handler(ctrl_httpd,&u);
    u = {.uri="/api/fw-check",  .method=HTTP_GET, .handler=h_fwcheck, .user_ctx=NULL}; httpd_register_uri_handler(ctrl_httpd,&u);
    u = {.uri="/api/light",     .method=HTTP_GET, .handler=h_light,   .user_ctx=NULL}; httpd_register_uri_handler(ctrl_httpd,&u);
    u = {.uri="/api/nonce",     .method=HTTP_GET, .handler=h_nonce,   .user_ctx=NULL}; httpd_register_uri_handler(ctrl_httpd,&u);
  }
  if (cameraOK) {
    httpd_config_t cfg2 = HTTPD_DEFAULT_CONFIG();
    cfg2.server_port = 81;
    cfg2.ctrl_port   = 32769;      // own control port, otherwise it clashes with the port 80 server
    cfg2.lru_purge_enable = true;  // drop the oldest connection when short
    cfg2.send_wait_timeout = 5;    // release dead clients within 5 s
    cfg2.recv_wait_timeout = 5;
    if (httpd_start(&stream_httpd, &cfg2) == ESP_OK) {
      httpd_uri_t u = {.uri="/stream", .method=HTTP_GET, .handler=h_stream, .user_ctx=NULL};
      httpd_register_uri_handler(stream_httpd, &u);
      logLine("Stream server: port 81 OK");
    } else {
      logLine("STREAM SERVER FAILED (port 81)");
    }
  } else {
    logLine("Stream server skipped (no camera)");
  }
}

/* ============================================================
 *  HEALTH PING (dead man's switch)
 *  A ping every 5 minutes to healthchecks.io. Sending nothing IS the
 *  alarm, so a dead camera simply skips the ping and lets the grace
 *  period expire — no need for an explicit failure signal.
 *  Gate on a real frame: without it we would only be reporting "the
 *  ESP32 has power", and a wedged camera is exactly the fault that
 *  otherwise never surfaces.
 * ============================================================ */
#define PING_INTERVAL_MS 300000UL   // 5 min. Pair with grace 15 min at the
                                    // other end: alerts 20 min after silence.
unsigned long lastPing = 0;

/* Lets the sensor's exposure catch up with the light before a frame is kept.
   Draining is what advances it: a buffer nobody empties holds whatever was
   captured before. Used on the boot path, where the light has just been
   switched on and the sensor has never seen the scene. */
void cameraSettle(unsigned long ms) {
  if (!cameraOK) return;
  unsigned long t0 = millis();
  while (millis() - t0 < ms) {
    camera_fb_t *fb = esp_camera_fb_get();
    if (fb) esp_camera_fb_return(fb);
    delay(30);
  }
}

bool cameraDelivers() {
  if (!cameraOK) return false;
  camera_fb_t *fb = esp_camera_fb_get();
  if (!fb) return false;
  bool ok = fb->len > 1000;         // a plausible JPEG, not a truncated frame
  esp_camera_fb_return(fb);
  return ok;
}

/* Blocks for the TLS handshake (1-3 s). That is fine here: the web server
   runs in its own task, so only the heartbeat LED pauses. */
bool pingHealth() {
  if (strlen(HEALTHCHECK_URL) == 0) return false;
  WiFiClientSecure client;
  client.setInsecure();             // no cert pinning. The ping carries no
                                    // secret, and a man in the middle can only
                                    // suppress it — which shows up as a missed
                                    // check, i.e. the alarm we already want.
  HTTPClient http;
  if (!http.begin(client, HEALTHCHECK_URL)) {
    logLine("Ping: begin failed");
    return false;
  }
  // Timeouts set on HTTPClient only: Client::setTimeout has meant seconds in
  // some core versions and milliseconds in others, and getting it wrong the
  // slow way would block loop() for a very long time.
  http.setConnectTimeout(5000);
  http.setTimeout(5000);
  int code = http.GET();
  http.end();
  // Only failures are logged, and at most one per hour. Successes would
  // flush the 40-line ring within hours, and so would a sustained outage —
  // which is exactly when the wifi lines above it are worth keeping.
  static unsigned long lastFailLog = 0;
  if (code != 200 && (lastFailLog == 0 || millis() - lastFailLog > 3600000UL)) {
    lastFailLog = millis();
    logLine(String("Ping: HTTP ") + code + ", heap " + ESP.getFreeHeap());
  }
  return code == 200;
}

/* ============================================================
 *  CLOUD UPLOAD
 *  One frame to the ingest Worker, which stores the image in R2 and a row
 *  in D1. Fire and forget: a failed upload is not retried and not
 *  buffered. A gap in the log IS the record that the device or the network
 *  was down, and buffering would only make a stale image look current.
 *  The reading itself is not computed here — the camera image is the
 *  record until an analysis path is validated against the labelled set.
 * ============================================================ */
#define UPLOAD_INTERVAL_MS 900000UL   // 15 min
#define PRESS_SETTLE_MS      5000UL   // quiet time that ends a press series
unsigned long lastUpload = 0;

// How often the device asks whether a human has armed a firmware build. Same
// 15 minutes as the upload: nothing is waiting for it, and a tighter poll
// would only spend her bandwidth on a question that is almost always "no".
#define FW_CHECK_INTERVAL_MS 900000UL
unsigned long lastFwCheck = 0;
/* Set by /api/fw-check: ask now instead of at the next quarter. It only moves
   the QUESTION forward — what gets installed is still only a build a person
   armed, so this cannot start an update by itself. Within
   FW_CHECK_MIN_GAP_MS of the last ask the request waits rather than runs —
   it is kept, and served once the gap has passed: each ask blocks loop() for
   a TLS request, and a page hammering the endpoint must not keep it blocked. The
   boot-loop guard is untouched — that is lastFwCheck seeded at boot, and the
   gap below applies from it as well. */
#define FW_CHECK_MIN_GAP_MS 30000UL

/* Blocks for a few seconds. Same reasoning as pingHealth(): the web server
   has its own task, so only the heartbeat pauses. */
bool uploadFrame(const char *reason) {
  if (strlen(INGEST_URL) == 0) return false;
  /* Lit like every other analysed frame, and this is not optional. The
     calibration is bound to one lighting; once the reference is swept under
     the LED, a frame taken in whatever ambient light happens to be in the
     kitchen fails the contrast gate. Leaving this out would mean every
     periodic upload is refused — the archive goes dark exactly where it is
     the only record, because nobody is watching when it is taken.

     A no-op while LED_ALWAYS_ON is 1. With it at 0 this is the one caller
     with no page behind it, which is why it gets the long settle: nothing is
     waiting on it, and it is the one frame that cannot be retaken. */
  ledForCapture(LED_SETTLE_UPLOAD_MS);
  camera_fb_t *fb = esp_camera_fb_get();
  if (!fb) return false;

  // Copy the JPEG and hand the frame buffer straight back. Holding it for the
  // whole TLS upload — up to 15 s on a weak link — starved /bild of buffers
  // and made the live page stutter while a picture was being sent.
  size_t len = fb->len;
  uint8_t *jpeg = (uint8_t *)ps_malloc(len);
  if (jpeg) memcpy(jpeg, fb->buf, len);
  esp_camera_fb_return(fb);
  if (!jpeg) { logLine("Upload: out of PSRAM"); return false; }

  String url = String(INGEST_URL) + "?reason=" + reason +
               "&position=" + position +
               "&steg=" + stepDegrees +
               "&uptime=" + (millis() / 1000) +
               "&rssi=" + WiFi.RSSI() +
               "&fw=" FW_VERSION
               "&preset=" PRESET_ID
               // The engine this firmware serves at /motor.js, by content hash
               // (generated into balldetector_js.h). fw alone cannot answer
               // "what did it read at the time": an engine is baked into a
               // firmware build but the two version numbers are unrelated, so
               // the admin page had to leave that column empty and say so.
               // With this it can attribute a stored reading to the engine
               // that was actually live when the frame was taken.
               "&motor=" ENGINE_VERSION;
  // The turn that caused this frame, signed. Only meaningful for a press.
  if (strcmp(reason, "press") == 0) url += String("&tryck=") + lastPressDegrees;

  WiFiClientSecure client;
  client.setInsecure();               // see pingHealth() for why
  HTTPClient http;
  bool ok = false;
  if (http.begin(client, url)) {
    http.setConnectTimeout(5000);
    http.setTimeout(15000);           // 30 kB over TLS on a weak link
    http.addHeader("authorization", "Bearer " INGEST_TOKEN);
    http.addHeader("content-type", "image/jpeg");
    int code = http.POST(jpeg, len);
    ok = (code == 204);
    // Rate-limited for the same reason as the ping: a sustained outage
    // would otherwise flush the 40-line ring and take the wifi lines that
    // explain the outage with it.
    static unsigned long lastFailLog = 0;
    if (!ok && (lastFailLog == 0 || millis() - lastFailLog > 3600000UL)) {
      lastFailLog = millis();
      logLine(String("Upload ") + reason + ": HTTP " + code +
              ", heap " + ESP.getFreeHeap());
    }
    http.end();
  }
  free(jpeg);
  return ok;
}

/* ============================================================
 *  SELF-HEALING WIFI (runtime)
 *  The boot path is healed by WiFiManager; this covers a network
 *  lost AFTER a successful start: 3 reconnect attempts 15 s apart,
 *  then a restart (WiFiManager takes over with the portal if needed).
 * ============================================================ */
unsigned long wifiLastTry = 0;
int wifiAttempts = 0;
void wifiWatchdog() {
  if (WiFi.status() == WL_CONNECTED) {
    // Back after a drop: ping straight away so the outage reads as a short
    // gap rather than a long one, and a brief blip never reaches the alarm.
    if (wifiAttempts > 0) lastPing = millis() - PING_INTERVAL_MS;
    wifiAttempts = 0;
    return;
  }
  unsigned long now = millis();
  if (now - wifiLastTry < 15000) return;
  wifiLastTry = now;
  wifiAttempts++;
  if (wifiAttempts <= 3) {
    logLine(String("Wifi lost - retry ") + wifiAttempts + "/3");
    WiFi.reconnect();
  } else {
    logLine("Wifi could not be restored - restarting");
    delay(200);
    ESP.restart();
  }
}

/* ============================================================
 *  SETUP / LOOP
 * ============================================================ */
/* ============================================================
 *  OVER-THE-AIR UPDATE
 *
 *  Flash over her wifi instead of over USB. The unit lives at the patient's
 *  home, so every avoided cable is an avoided trip — but read the limits:
 *
 *  - LAN only. espota talks to the device directly, so the laptop has to be
 *    on the same network. This removes the cable from a visit; it does not
 *    remove the visit. Updating from somewhere else needs the device to pull
 *    a build from the cloud, which is a different design and a bigger one.
 *  - No rollback. The Arduino core does not enable the bootloader's rollback
 *    partition check, so a firmware that boots badly cannot fall back on its
 *    own — that still takes USB. What makes this acceptable here is that the
 *    concentrator does not depend on the ESP32 at all: the driver idles
 *    disabled, the knob turns by hand, and a bricked unit costs the remote
 *    control, not the oxygen.
 *  - Never automatic. The device only ever accepts an update that a human
 *    pushed to it. It does not look for one, and must not be made to.
 *
 *  The password is required, not optional: this opens a port that can replace
 *  the firmware driving a motor attached to medical equipment, and "only
 *  people on her wifi" is not an access policy. With no password compiled in,
 *  OTA stays off rather than open. Same caveat as the other secrets — it sits
 *  in the image and esptool can read it back, so it defends against the
 *  network, not against someone holding the device.
 * ============================================================ */
const uint16_t OTA_PORT = 3232;

/* Give the update the whole machine.

   Writing to flash on an ESP32 disables the cache and stalls every other task
   while it happens. Meanwhile this device grabs camera frames continuously
   (CAMERA_GRAB_WHEN_EMPTY never idles) and answers on two HTTP ports. The
   first real ArduinoOTA attempt died at 9% with "receive failed": the incoming
   TCP stream went quiet for longer than the receive timeout because nothing
   was left to service it. Raising the timeout alone treats the symptom.

   So both update paths stop the camera and both servers first. Nothing is lost
   on success — the device reboots into the new firmware moments later. On
   failure they come back, because the alternative is a unit sitting at a
   patient's home with a dead camera because a download was interrupted. A
   restart would also fix that, but rebooting on every failed attempt turns a
   flaky network into a reboot loop once a cloud build is armed.

   The order is load-bearing: servers first, camera last. h_snapshot and
   h_stream touch the frame buffer from the server tasks, and httpd_stop()
   blocks until a running handler returns — so by the time the camera is
   deinitialised nobody is holding a frame. Deinitialising first would free
   buffers out from under a request that is still being served. */
void otaQuiesce() {
  if (stream_httpd) { httpd_stop(stream_httpd); stream_httpd = NULL; }
  if (ctrl_httpd)   { httpd_stop(ctrl_httpd);   ctrl_httpd   = NULL; }
  if (cameraOK)     { esp_camera_deinit();      cameraOK     = false; }
}

/* Tears down before bringing up, so calling this twice is harmless.

   That is not hypothetical. ArduinoOTA's connect-failure branch sets the state
   and calls the error callback but does NOT return, so it falls through to the
   end() check, fails there too, and calls the error callback a second time
   with OTA_END_ERROR. Without the teardown the second call would run
   cameraInit() on a live camera — esp_camera_init refuses, cameraInit returns
   false, and cameraOK sticks at false. The camera would be physically fine
   while /bild and every cloud upload stopped, and startWebServer() guards the
   stream server behind cameraOK, so that would not come back either. Two
   servers would meanwhile be started on ports already bound, leaking the
   first pair. One failed connect, and the unit is blind until someone drives
   over and power-cycles it. */
void otaResume() {
  otaQuiesce();
  cameraOK = cameraInit();
  if (!cameraOK) {
    // Nothing here can fix a camera that will not come back, and a unit with
    // no picture is a unit with no truth: the whole system rests on her being
    // able to see the meter. Restarting is what wifiWatchdog() already does
    // with a fault it cannot mend, and it costs ten seconds against sitting
    // blind at her home until someone drives over.
    logLine("OTA: CAMERA DID NOT RESTART - restarting the device");
    delay(200);                   // let the line reach the serial console
    ESP.restart();
  }
  startWebServer();
  logLine("OTA: camera and web server back up");
}

void otaInit() {
  if (!strlen(OTA_PASSWORD)) {
    logLine("OTA: off (no password in secrets.h)");
    return;
  }
  ArduinoOTA.setHostname("syrgas");
  ArduinoOTA.setPassword(OTA_PASSWORD);
  // mDNS is already running from setup(); ArduinoOTA.begin() would call
  // MDNS.begin() a second time, which fails with "already initialized" and
  // logs an error that looks like a fault. Advertise the service by hand
  // instead — that record is what makes the IDE list syrgas as a network port.
  ArduinoOTA.setMdnsEnabled(false);

  /* The receive loop waits this long for the next packet before it gives up
     (three retries, then OTA_RECEIVE_ERROR). The library default is 1000 ms,
     and 1 s turned out to be no budget at all here: an ESP32 flash write
     disables the cache and stalls other tasks, and this device is also
     grabbing camera frames continuously and running two HTTP servers. The
     first real attempt died at 9% with exactly that error while the sender
     saw a broken pipe. Five seconds costs nothing when the transfer is
     healthy — the timeout is only reached when it is not. */
  ArduinoOTA.setTimeout(5000);

  ArduinoOTA.onStart([]() {
    // Runs before the download connects and long before anything is written to
    // flash, so this is where the two tasks are brought to a stop. Setting the
    // flag shuts the door on new presses; the wait lets one that squeezed
    // through move()'s check a moment earlier finish turning first. A press is
    // a second or two, so the ceiling is never reached in practice — it is
    // there so a wedged move cannot hold the update forever.
    otaActive = true;
    for (int i = 0; i < 100 && busy; i++) delay(50);   // <= 5 s
    motorRelease();               // iron rule 4: never energised outside a move
    logLine(busy ? "OTA: update starting, motor did NOT finish - released anyway"
                 : "OTA: update starting, motor released");
    otaQuiesce();                 // camera and servers off for the duration
  });
  ArduinoOTA.onEnd([]() {
    logLine("OTA: written, restarting into the new firmware");
  });
  ArduinoOTA.onError([](ota_error_t e) {
    // A failed update leaves the running firmware untouched, so the honest
    // thing is to go back to normal service rather than sit in a half state.
    otaActive = false;
    motorRelease();
    otaResume();
    logLine(String("OTA: FAILED (") +
            (e == OTA_AUTH_ERROR    ? "wrong password"
           : e == OTA_BEGIN_ERROR   ? "could not start"
           : e == OTA_CONNECT_ERROR ? "connection lost"
           : e == OTA_RECEIVE_ERROR ? "receive failed"
           : e == OTA_END_ERROR     ? "could not finish"
                                    : "unknown") + "), still on v" FW_VERSION);
  });
  ArduinoOTA.begin();
  MDNS.enableArduino(OTA_PORT, true);   // true = advertise that auth is required
  logLine("OTA: on, syrgas.local:" + String(OTA_PORT) + " (password required)");
}

/* ---------- cloud-pull OTA ----------
   The other half of the story above: this one works from anywhere, because
   the device fetches instead of being pushed to. The rule it must not break
   is that an update still happens only because a human decided so, and the
   cloud keeps that — a published build is inert until someone arms it with a
   separate command, and the device is told nothing until then. It never
   chooses to update; it asks whether a person has left one waiting.

   Recovery is unchanged and unglamorous: there is no bootloader rollback, so
   a firmware that does not boot is fixed over USB, at her home. Arm only a
   build that has already been seen to boot. See tools/publish_firmware.mjs.

   The MD5 is checked by HTTPUpdate against the x-MD5 header. That catches a
   corrupted download, not a hostile one — anyone who can write the R2 object
   or the D1 row owns this device.

   THIS IS THE ONE PLACE THE CERTIFICATE IS VERIFIED. Everywhere else in this
   sketch uses setInsecure(), and that was a fair trade when the worst a
   man-in-the-middle could do was read a picture of a flow meter or collect a
   token that can only write readings. It stops being fair the moment the same
   connection can hand the device its next firmware: anyone able to intercept
   it on her network could then run whatever they liked on hardware bolted to
   an oxygen concentrator. Unverified TLS plus OTA is remote code execution
   with extra steps.

   So both firmware requests pin the roots the Worker's certificate actually
   chains to (verified against the live chain 2026-08-17): GTS Root R4, which
   Cloudflare currently issues from, and ISRG Root X1, because they rotate
   between CAs and a rotation must not brick the update path. If they ever move
   to a third CA, verification fails and the update simply does not happen —
   the safe direction, and ArduinoOTA over the LAN is still there to fix it. */
#include "cloud_roots.h"
String cloudUrl(const char* path) {
  String base = INGEST_URL;
  int i = base.lastIndexOf("/ingest");     // the only endpoint in the URL
  if (i > 0) base = base.substring(0, i);
  return base + path;
}

void checkFirmware() {
  if (!strlen(INGEST_URL) || !strlen(INGEST_TOKEN)) return;
  if (busy || otaActive) return;

  // The ask lives in its own scope so its TLS session is torn down before the
  // download opens a second one. A WiFiClientSecure holds tens of kB of heap,
  // and two of them alive at once on a device that also owns a camera is how
  // an update fails at the last moment, on the unit, out of reach.
  String ver;
  {
    WiFiClientSecure client;
    client.setCACert(CLOUD_ROOT_CA);       // verified, unlike the rest — see above
    HTTPClient http;
    if (!http.begin(client, cloudUrl("/firmware") + "?fw=" FW_VERSION)) return;
    http.setConnectTimeout(5000);
    http.setTimeout(10000);
    http.addHeader("authorization", "Bearer " INGEST_TOKEN);
    int code = http.GET();
    // 204 is the normal answer and means "nothing armed", or "what is armed is
    // what you are already running". Anything else is silence by design: a
    // failed check must cost nothing, it runs every 15 minutes forever.
    String body = (code == 200) ? http.getString() : String();
    http.end();
    if (code != 200) return;

    int a = body.indexOf("\"version\":\"");
    if (a < 0) return;
    a += 11;
    int b = body.indexOf('"', a);
    if (b < 0) return;
    ver = body.substring(a, b);
  }
  if (ver.length() == 0 || ver.length() > 16 || ver == FW_VERSION) return;

  logLine("Cloud OTA: v" + ver + " is armed, installing (running v" FW_VERSION ")");

  // Same interlock as ArduinoOTA: shut the door on new presses, then let one
  // already in flight finish before anything touches flash.
  otaActive = true;
  for (int i = 0; i < 100 && busy; i++) delay(50);   // <= 5 s
  motorRelease();
  otaQuiesce();                   // camera and servers off for the duration

  WiFiClientSecure dl;
  dl.setCACert(CLOUD_ROOT_CA);      // the download above all must be authentic
  HTTPUpdate updater(30000);        // per-read timeout; 1.4 MB over a weak link
  updater.rebootOnUpdate(true);
  updater.setFollowRedirects(HTTPC_DISABLE_FOLLOW_REDIRECTS);
  t_httpUpdate_return r = updater.update(
      dl, cloudUrl("/firmware.bin") + "?v=" + ver, "",
      [](HTTPClient* h) { h->addHeader("authorization", "Bearer " INGEST_TOKEN); });

  // Only reached when it did NOT reboot, so every path here is a failure and
  // the running firmware is untouched. Back to normal service: refusing to
  // move the knob because an update failed hours ago would be the worse bug.
  otaActive = false;
  otaResume();
  logLine(String("Cloud OTA: FAILED (") +
          (r == HTTP_UPDATE_NO_UPDATES ? "server had nothing" : updater.getLastErrorString()) +
          "), still on v" FW_VERSION);
}

void setup() {
  Serial.begin(115200);
  delay(300);
  pinMode(HEARTBEAT_PIN, OUTPUT);
  digitalWrite(HEARTBEAT_PIN, HIGH);   // off (active low)
  esp_log_level_set("cam_hal", ESP_LOG_ERROR);  // silence harmless FB-OVF warnings
  logLine("=== EverFlo remote control v" FW_VERSION " starting ===");

  prefs.begin("everflo", false);
  position = prefs.getInt("lage", 0);
  Serial.printf("Stored position: %d\n", position);

  motorInit();
  Serial.printf("Motor: NEMA17+TMC2209, %d degrees/press\n", DEG_PER_PRESS);
  logLine("Concentrator preset: " PRESET_ID);

  ledInit();

  esp_log_level_set("cam_hal", ESP_LOG_NONE);  // silence harmless FB-OVF lines
  cameraOK = cameraInit();
  logLine(cameraOK ? "Camera OK" : "CAMERA FAILED (check the PSRAM setting!)");

  // Captive portal: the first time (or when no saved wifi exists) the XIAO
  // starts its own hotspot "Syrgas-setup". Connect with the phone, pick the
  // home wifi and enter the password. After that it connects on its own.
  WiFiManager wm;
  wm.setHostname("syrgas");
  wm.setConnectTimeout(15);        // per attempt
  wm.setConnectRetries(3);         // three attempts before the portal
  wm.setConfigPortalTimeout(120);  // portal max 2 min, then restart + new attempt
  if (!wm.autoConnect("Syrgas-setup")) {
    logLine("Wifi failed - restarting and trying again");
    delay(500);
    ESP.restart();
  }
  logLine(String("Connected! IP: ") + WiFi.localIP().toString());

  bool mdnsOK = MDNS.begin("syrgas");
  if (mdnsOK) Serial.println("Address: http://syrgas.local");

  // After MDNS.begin: otaInit() registers the _arduino._tcp record on it.
  // Without mDNS the update still works, but only by IP — the IDE's port list
  // is mDNS, so say so rather than let it look broken.
  if (mdnsOK) otaInit();
  else logLine("OTA: off (mDNS failed, so the IDE cannot discover the device)");

  startWebServer();
  Serial.println("Web page: port 80, stream: port 81");
  logLine(strlen(HEALTHCHECK_URL) ? "Health ping: on, every 5 min"
                                  : "Health ping: off (not configured)");
  logLine(strlen(INGEST_URL) ? "Cloud upload: on, every 15 min and after presses"
                             : "Cloud upload: off (not configured)");
  logLine("=== Ready ===");

  lastPing = millis();
  lastUpload = millis();
  // Not zero: a device stuck in a boot loop would otherwise ask for an update
  // within seconds of every boot, and the build it is offered is the one that
  // is crashing it. A full interval of running first is the cheapest guard
  // against an armed bad build turning into a loop that reinstalls itself.
  lastFwCheck = millis();
  // The result of the first attempt is logged even on success. Everything
  // after this only logs failures, but on a first boot at the installation
  // site /log is the only way to see that the cloud path actually works —
  // absence of errors is not the same as proof it went through.
  /* Write the pixel again before the one frame that cannot be retaken.
     ledInit() writes it once, near the top of setup(), and nothing writes it
     again until loop() starts — which is AFTER this upload. If that first
     write does not take, and it evidently does not, the lamp stays dark for
     the whole of setup() and the boot frame is a photograph of an unlit room.

     Measured 2026-08-22 over three boots: mean brightness 6.8, 8.3 and 8.6 in
     the tube against 108 for every later frame. What settles it is the glare
     the LED throws beside the tube — in a normal frame that band reads 175
     against the tube's 108 and saturates at 255, and in these three it read
     8.5 against 8.6 with a brightest pixel of 14. A ratio of 1.0 is not a
     mis-set exposure, it is no light source in the picture.

     ledDirty forces the write: ledApply() skips one when the state it wants
     is the state it thinks it already has, which here is exactly the belief
     that is wrong. Then settle, because the sensor has just been handed a lit
     room it has never seen. */
  ledDirty = true;
  ledApply();
  cameraSettle(5000);
  if (cameraDelivers()) {
    bool ping = pingHealth();           // boot ping shortens the outage gap
    bool up = uploadFrame("boot");      // and one frame of "this is how it looked"
    if (strlen(HEALTHCHECK_URL)) logLine(ping ? "Boot ping: OK" : "Boot ping: FAILED");
    if (strlen(INGEST_URL))      logLine(up   ? "Boot upload: OK" : "Boot upload: FAILED");
  } else {
    logLine("Boot: camera gave no frame, skipped ping and upload");
  }
}

void loop() {
  wifiWatchdog();

  // Not while the knob is turning: move() runs on the web server's task and
  // blocks there, so this is the only point where the two can be separated.
  // handle() returns immediately when no update is in flight.
  if (!busy) ArduinoOTA.handle();

  bool online = !busy && !otaActive && WiFi.status() == WL_CONNECTED;

  if (online && millis() - lastPing > PING_INTERVAL_MS) {
    lastPing = millis();                 // reset first: a failed camera must
    if (cameraDelivers()) pingHealth();  // retry in 5 min, not spin
  }

  // A finished press series wins over the periodic slot: it is the frame
  // that shows what the adjustment actually did.
  if (online && uploadAfterPress && millis() - lastPressAt > PRESS_SETTLE_MS) {
    uploadAfterPress = false;
    lastUpload = millis();
    uploadFrame("press");
  } else if (online && millis() - lastUpload > UPLOAD_INTERVAL_MS) {
    lastUpload = millis();
    uploadFrame("periodic");
  }

  // Asks whether a human has armed a build. Never installs one it was not
  // offered, and the offer only exists because a person made it. Deliberately
  // after the upload branch: a reading is what she depends on, an update is
  // convenience for me, and the reading goes first when both are due.
  if (online && (millis() - lastFwCheck > FW_CHECK_INTERVAL_MS ||
                 (fwCheckRequested && millis() - lastFwCheck > FW_CHECK_MIN_GAP_MS))) {
    fwCheckRequested = false;
    lastFwCheck = millis();
    checkFirmware();
  }

  // The pixel's off-switch: the handlers only stamp a time, the state itself
  // is settled here. ledApply() returns early while the colour test is
  // running, so the two never fight over the pixel.
  ledTestUpdate();
  ledApply();

  static bool on = false;
  static unsigned long t = 0;
  unsigned long now = millis();
  if (on && now - t > 1000) {         // 1 s lit ...
    on = false; t = now; digitalWrite(HEARTBEAT_PIN, HIGH);
  } else if (!on && now - t > 4000) { // ... 4 s dark
    on = true;  t = now; digitalWrite(HEARTBEAT_PIN, LOW);
  }
  delay(50);
}
